# tle984x register map
Vendor: Infineon; File version: 1.9.5
TLE984x Family
CPU: CM0 r2p1, little endian, no MPU, no FPU, 2 interrupt priority bits
Registers are 32-bit, read-write, reset 0x0 unless marked. A register's access mark holds for its fields unless they carry their own. Offsets are from the block's base; lines under a group give offsets from that group; [hi:lo] are bit positions; {n}, {i} and the like mark numbered series; 'fields as' and 'values as' point back to an identical list; <NAME> marks a mode.

## Memory map
0x40004000 ADC1 size 0x4000 — 10-bit Analog Digital Converter (ADC1) registers
0x4000C000 CCU6 size 0x4000 — Capture/Compare Unit 6 (CCU6) registers
0x40010000 GPT12E size 0x4000 — General purpose timer units (GPT12) registers
0x4001C000 LS size 0x4000 — Low-side switch registers
0x40024000 HS size 0x4000 — High-side switch registers
0x48004000 TIMER2 size 0x1000 — Timer2 registers
0x48005000 TIMER21 size 0x1000 — Timer21 registers
0x48018000 MF size 0x4000 — Measurement unit registers
0x4801C000 ADC2 size 0x2000 — Measurement core module (incl. ADC2) registers
0x4801E000 TRX size 0x2000 — Transceiver registers
0x48020000 UART1 size 0x2000 — UART1 registers
0x48022000 UART2 size 0x2000 — UART2 registers
0x48024000 SSC1 size 0x2000 — High-Speed Synchronous Serial Interface SSC1 registers
0x48026000 SSC2 size 0x2000 — High-Speed Synchronous Serial Interface SSC2 registers
0x48028000 PORT size 0x2000 — Ports registers
0x50004000 PMU size 0x1000 — Power Management Unit registers
0x50005000 SCU size 0x1000 — System Control Unit - Digital Modules (SCU-DM) registers
0x50006000 SCUPM size 0x1000 — System Control Unit - Power Modules (SCU-PM)
0xE000E000 CPU size 0x1000 — CPU processor registers

## Interrupts
0 GPT1_Int (CPU) — Interrupt node 0: GPT1 Block
1 GPT2_Int (CPU) — Interrupt node 1: GPT2 Block
2 ADC2_Int (CPU) — Interrupt node 2: ADC2
3 ADC1_Int (CPU) — Interrupt node 3: ADC10 bit
4 CCU6_SR0_Int (CPU) — Interrupt node 4: CCU6 node0
5 CCU6_SR1_Int (CPU) — Interrupt node 5: CCU6 node1
6 CCU6_SR2_Int (CPU) — Interrupt node 6: CCU6 node2
7 CCU6_SR3_Int (CPU) — Interrupt node 7: CCU6 node3
8 SSC1_Int (CPU) — Interrupt node 8: SSC1
9 SSC2_Int (CPU) — Interrupt node 9: SSC2
10 UART1_LIN_Tmr2_Int (CPU) — Interrupt node10: UART1(ASC,LIN), Timer2
11 UART2_Tmr21_EINT2_Int (CPU) — Interrupt node11: UART2, Timer21, EINT2
12 EXINT0_Int (CPU) — Interrupt node12: EINT0
13 EXINT1_Int (CPU) — Interrupt node13: EINT1
14 WAKEUP_Int (CPU) — Interrupt node14: Wake-up
17 LS1_Int (CPU) — Interrupt node17: Low-side 1
18 LS2_Int (CPU) — Interrupt node18: Low-side 2
19 HS1_Int (CPU) — Interrupt node19: High-side 1
20 HS2_Int (CPU) — Interrupt node20: High-side 2
21 DU_Int (CPU) — Interrupt node21: Differential unit - DPP1 (product variant dependent, only TLE9845QX)
22 MON_Int (CPU) — Interrupt node22: MONx
23 PORT2X_Int (CPU) — Interrupt node23: Port 2.x - DPP1

## Licence text in the file
Copyright (c) 2022 Infineon Technologies AG . Permission is hereby granted, free of charge, to any person or organization obtaining a copy of the software and accompanying documentation covered by this license (the "Software") to use, reproduce, display, distribute, execute, and transmit the Software, and to prepare derivative works of the Software, and to permit third-parties to whom the Software is furnished to do so, all subject to the following: . The copyright notices in the Software and this entire statement, including the above license grant, this restriction and the following disclaimer, must be included in all copies of the Software, in whole or in part, and all derivative works of the Software, unless such copies or derivative works are solely in the form of machine-executable object code generated by a source language processor. . THE SOFTWARE IS PROVIDED "AS IS", WITHOUT WARRANTY OF ANY KIND, EXPRESS OR IMPLIED, INCLUDING BUT. NOT LIMITED TO THE WARRANTIES OF MERCHANTABILITY, FITNESS FOR A PARTICULAR PURPOSE, TITLE AND. NON-INFRINGEMENT. IN NO EVENT SHALL THE COPYRIGHT HOLDERS OR ANYONE DISTRIBUTING THE SOFTWARE BE. LIABLE FOR ANY DAMAGES OR OTHER LIABILITY, WHETHER IN CONTRACT, TORT OR OTHERWISE, ARISING FROM, OUT OF OR IN CONNECTION WITH THE SOFTWARE OR THE USE OR OTHER DEALINGS IN THE SOFTWARE.
