# EFM32GG11B420F2048IQ100 register map
File version: 4.0.0
Silicon Labs EFM32GG11B420F2048IQ100 Cortex-M MCU
CPU: CM4 r0p1, little endian, MPU, FPU, 3 interrupt priority bits
Registers are 32-bit, read-write, reset 0x0 unless marked. A register's access mark holds for its fields unless they carry their own. Offsets are from the block's base; lines under a group give offsets from that group; [hi:lo] are bit positions; {n}, {i} and the like mark numbered series; 'fields as' and 'values as' point back to an identical list; <NAME> marks a mode.

## Memory map
0x40000000 MSC size 0x800
0x40001000 FPUEH size 0x400
0x40002000 LDMA size 0x1000
0x40004000 CAN0 size 0x400
0x40004400 CAN1 size 0x400
0x4000B000 EBI size 0x400
0x40010000 USART0 size 0x400
0x40010400 USART1 size 0x400
0x40010800 USART2 size 0x400
0x40010C00 USART3 size 0x400
0x40011000 USART4 size 0x400
0x40011400 USART5 size 0x400
0x40014000 UART0 size 0x400
0x40014400 UART1 size 0x400
0x40018000 TIMER0 size 0x400
0x40018400 TIMER1 size 0x400
0x40018800 TIMER2 size 0x400
0x40018C00 TIMER3 size 0x400
0x40019000 TIMER4 size 0x400
0x40019400 TIMER5 size 0x400
0x40019800 TIMER6 size 0x400
0x4001A000 WTIMER0 size 0x400
0x4001A400 WTIMER1 size 0x400
0x4001A800 WTIMER2 size 0x400
0x4001AC00 WTIMER3 size 0x400
0x4001C000 GPCRC size 0x400
0x4001C400 QSPI0 size 0x400
0x4001D000 TRNG0 size 0x400
0x40020000 SMU size 0x400
0x40022000 USB blocks up to offset 0xDF000
0x40024000 ETH size 0x1000
0x40052000 WDOG0 size 0x400
0x40052400 WDOG1 size 0x400
0x40054000 LCD size 0x400
0x40055000 LESENSE size 0x400
0x40060000 RTC size 0x400
0x40062000 RTCC size 0x400
0x40066000 LETIMER0 size 0x400
0x40066400 LETIMER1 size 0x400
0x4006A000 LEUART0 size 0x400
0x4006A400 LEUART1 size 0x400
0x4006E000 PCNT0 size 0x400
0x4006E400 PCNT1 size 0x400
0x4006E800 PCNT2 size 0x400
0x40080000 ACMP0 size 0x400
0x40080400 ACMP1 size 0x400
0x40080800 ACMP2 size 0x400
0x40080C00 ACMP3 size 0x400
0x40082000 ADC0 size 0x400
0x40082400 ADC1 size 0x400
0x40084000 IDAC0 size 0x400
0x40086000 VDAC0 size 0x400
0x40088000 GPIO size 0x1000
0x40089000 I2C0 size 0x400
0x40089400 I2C1 size 0x400
0x40089800 I2C2 size 0x400
0x4008E000 CSEN size 0x400
0x4008F000 CRYOTIMER size 0x400
0x400E3000 EMU size 0x400
0x400E4000 CMU size 0x400
0x400E5000 RMU size 0x400
0x400E6000 PRS size 0x400
0x400F0000 CRYPTO0 size 0x400
0x400F1000 SDIO size 0x1000
0xE0041000 ETM size 0x40000

## Interrupts
0 EMU
1 WDOG0
2 LDMA
3 GPIO_EVEN (GPIO)
4 SMU
5 TIMER0
6 USART0_RX (USART0)
7 USART0_TX (USART0)
8 ACMP0 (ACMP0, ACMP1)
9 ADC0
10 IDAC0
11 I2C0
12 I2C1
13 GPIO_ODD (GPIO)
14 TIMER1
15 TIMER2
16 TIMER3
17 USART1_RX (USART1)
18 USART1_TX (USART1)
19 USART2_RX (USART2)
20 USART2_TX (USART2)
21 UART0_RX (UART0)
22 UART0_TX (UART0)
23 UART1_RX (UART1)
24 UART1_TX (UART1)
25 LEUART0
26 LEUART1
27 LETIMER0
28 PCNT0
29 PCNT1
30 PCNT2
31 RTCC
32 CMU
33 MSC
34 CRYPTO0
35 CRYOTIMER
36 FPUEH
37 USART3_RX (USART3)
38 USART3_TX (USART3)
39 USART4_RX (USART4)
40 USART4_TX (USART4)
41 WTIMER0
42 WTIMER1
43 WTIMER2
44 WTIMER3
45 I2C2
46 VDAC0
47 TIMER4
48 TIMER5
49 TIMER6
50 USART5_RX (USART5)
51 USART5_TX (USART5)
52 CSEN
53 LESENSE
54 EBI
55 ACMP2 (ACMP2, ACMP3)
56 ADC1
57 LCD
58 SDIO
59 ETH
60 CAN0
61 CAN1
62 USB
63 RTC
64 WDOG1
65 LETIMER1
66 TRNG0
67 QSPI0

## Further device data
name=Copyright 2021 Silicon Laboratories, Inc., flashBaseAddress=0x00000000, flashSize=0x00200000, flashAccessTypes=rx, sramBaseAddress=0x20000000, sramSize=0x00080000, sramAccessTypes=rwx

## Licence text in the file
******************************************************************************* * # License * Copyright 2021 Silicon Laboratories Inc. www.silabs.com ******************************************************************************* * * SPDX-License-Identifier: Zlib * * The licensor of this software is Silicon Laboratories Inc. * * This software is provided 'as-is', without any express or implied * warranty. In no event will the authors be held liable for any damages * arising from the use of this software. * * Permission is granted to anyone to use this software for any purpose, * including commercial applications, and to alter it and redistribute it * freely, subject to the following restrictions: * * 1. The origin of this software must not be misrepresented; you must not * claim that you wrote the original software. If you use this software * in a product, an acknowledgment in the product documentation would be * appreciated but is not required. * 2. Altered source versions must be plainly marked as such, and must not be * misrepresented as being the original software. * 3. This notice may not be removed or altered from any source distribution. * *******************************************************************************
