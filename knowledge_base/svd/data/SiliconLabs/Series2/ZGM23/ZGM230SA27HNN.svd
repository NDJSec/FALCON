# ZGM230SA27HNN register map
Vendor: Silicon Labs; Series: EFR32; File version: 1
Z-wave Gecko Bluetooth Module, 230, SIP, Secure Element, 14 dBm TX, 868 & 915 MHz, 512 kB Flash, -40 to 105 C, RF Pin, Engineering
Registers are 32-bit, read-write, reset 0x0 unless marked. A register's access mark holds for its fields unless they carry their own. Offsets are from the block's base; lines under a group give offsets from that group; [hi:lo] are bit positions; {n}, {i} and the like mark numbered series; 'fields as' and 'values as' point back to an identical list; <NAME> marks a mode.

## Memory map
0x0FE08000 DEVINFO size 0x1000 — DEVINFO Registers
0x40000000 SCRATCHPAD_S size 0x1000 — SCRATCHPAD_S Registers
0x40004000 EMU_S size 0x1000 — EMU_S Registers
0x40008000 CMU_S size 0x1000 — CMU_S Registers
0x40010000 HFRCO0_S size 0x1000 — HFRCO0_S Registers
0x40018000 FSRCO_S size 0x1000 — FSRCO_S Registers
0x4001C000 DPLL0_S size 0x1000 — DPLL0_S Registers
0x40020000 LFXO_S size 0x1000 — LFXO_S Registers
0x40024000 LFRCO_S size 0x1000 — LFRCO_S Registers
0x40028000 ULFRCO_S size 0x1000 — ULFRCO_S Registers
0x40030000 MSC_S size 0x1000 — MSC_S Registers
0x40034000 ICACHE0_S size 0x1000 — ICACHE0_S Registers
0x40038000 PRS_S size 0x1000 — PRS_S Registers
0x4003C000 GPIO_S size 0x1000 — GPIO_S Registers
0x40040000 LDMA_S size 0x1000 — LDMA_S Registers
0x40044000 LDMAXBAR_S size 0x1000 — LDMAXBAR_S Registers
0x40048000 TIMER0_S size 0x1000 — TIMER0_S Registers
0x4004C000 TIMER1_S size 0x1000 — TIMER1_S Registers
0x40050000 TIMER2_S size 0x1000 — TIMER2_S Registers
0x40054000 TIMER3_S size 0x1000 — TIMER3_S Registers
0x40058000 TIMER4_S size 0x1000 — TIMER4_S Registers
0x4005C000 USART0_S size 0x1000 — USART0_S Registers
0x40064000 BURTC_S size 0x1000 — BURTC_S Registers
0x40068000 I2C1_S size 0x1000 — I2C1_S Registers
0x40078000 SYSCFG_S_CFGNS size 0x1000 — SYSCFG_S_CFGNS Registers
0x4007C000 SYSCFG_S size 0x1000 — SYSCFG_S Registers
0x40080000 BURAM_S size 0x1000 — BURAM_S Registers
0x40088000 GPCRC_S size 0x1000 — GPCRC_S Registers
0x40094000 DCDC_S size 0x1000 — DCDC_S Registers
0x40098000 HOSTMAILBOX_S size 0x1000 — HOSTMAILBOX_S Registers
0x400A0000 EUSART1_S size 0x1000 — EUSART1_S Registers
0x400A4000 EUSART2_S size 0x1000 — EUSART2_S Registers
0x400A8000 SYSRTC0_S size 0x1000 — SYSRTC0_S Registers
0x400AC000 LCD_S size 0x1000 — LCD_S Registers
0x400B0000 KEYSCAN_S size 0x1000 — KEYSCAN_S Registers
0x400B4000 DMEM_S size 0x1000 — DMEM_S Registers
0x400C0000 LCDRF_S size 0x1000 — LCDRF_S Registers
0x400C4000 PFMXPPRF_S size 0x1000 — PFMXPPRF_S Registers
0x44000000 RADIOAES_S size 0x1000 — RADIOAES_S Registers
0x44008000 SMU_S size 0x1000 — SMU_S Registers
0x4400C000 SMU_S_CFGNS size 0x1000 — SMU_S_CFGNS Registers
0x49000000 LETIMER0_S size 0x1000 — LETIMER0_S Registers
0x49004000 IADC0_S size 0x1000 — IADC0_S Registers
0x49008000 ACMP0_S size 0x1000 — ACMP0_S Registers
0x4900C000 ACMP1_S size 0x1000 — ACMP1_S Registers
0x49020000 AMUXCP0_S size 0x1000 — AMUXCP0_S Registers
0x49024000 VDAC0_S size 0x1000 — VDAC0_S Registers
0x49030000 PCNT0_S size 0x1000 — PCNT0_S Registers
0x49038000 LESENSE_S size 0x1000 — LESENSE_S Registers
0x4A000000 HFRCOEM23_S size 0x1000 — HFRCOEM23_S Registers
0x4A004000 HFXO0_S size 0x1000 — HFXO0_S Registers
0x4B000000 I2C0_S size 0x1000 — I2C0_S Registers
0x4B004000 WDOG0_S size 0x1000 — WDOG0_S Registers
0x4B008000 WDOG1_S size 0x1000 — WDOG1_S Registers
0x4B010000 EUSART0_S size 0x1000 — EUSART0_S Registers
0x4C000000 SEMAILBOX_S_HOST size 0x1000 — SEMAILBOX_S_HOST Registers
0x50000000 SCRATCHPAD_NS size 0x1000 — SCRATCHPAD_NS Registers
0x50004000 EMU_NS size 0x1000 — EMU_NS Registers
0x50008000 CMU_NS size 0x1000 — CMU_NS Registers
0x50010000 HFRCO0_NS size 0x1000 — HFRCO0_NS Registers
0x50018000 FSRCO_NS size 0x1000 — FSRCO_NS Registers
0x5001C000 DPLL0_NS size 0x1000 — DPLL0_NS Registers
0x50020000 LFXO_NS size 0x1000 — LFXO_NS Registers
0x50024000 LFRCO_NS size 0x1000 — LFRCO_NS Registers
0x50028000 ULFRCO_NS size 0x1000 — ULFRCO_NS Registers
0x50030000 MSC_NS size 0x1000 — MSC_NS Registers
0x50034000 ICACHE0_NS size 0x1000 — ICACHE0_NS Registers
0x50038000 PRS_NS size 0x1000 — PRS_NS Registers
0x5003C000 GPIO_NS size 0x1000 — GPIO_NS Registers
0x50040000 LDMA_NS size 0x1000 — LDMA_NS Registers
0x50044000 LDMAXBAR_NS size 0x1000 — LDMAXBAR_NS Registers
0x50048000 TIMER0_NS size 0x1000 — TIMER0_NS Registers
0x5004C000 TIMER1_NS size 0x1000 — TIMER1_NS Registers
0x50050000 TIMER2_NS size 0x1000 — TIMER2_NS Registers
0x50054000 TIMER3_NS size 0x1000 — TIMER3_NS Registers
0x50058000 TIMER4_NS size 0x1000 — TIMER4_NS Registers
0x5005C000 USART0_NS size 0x1000 — USART0_NS Registers
0x50064000 BURTC_NS size 0x1000 — BURTC_NS Registers
0x50068000 I2C1_NS size 0x1000 — I2C1_NS Registers
0x50078000 SYSCFG_NS_CFGNS size 0x1000 — SYSCFG_NS_CFGNS Registers
0x5007C000 SYSCFG_NS size 0x1000 — SYSCFG_NS Registers
0x50080000 BURAM_NS size 0x1000 — BURAM_NS Registers
0x50088000 GPCRC_NS size 0x1000 — GPCRC_NS Registers
0x50094000 DCDC_NS size 0x1000 — DCDC_NS Registers
0x50098000 HOSTMAILBOX_NS size 0x1000 — HOSTMAILBOX_NS Registers
0x500A0000 EUSART1_NS size 0x1000 — EUSART1_NS Registers
0x500A4000 EUSART2_NS size 0x1000 — EUSART2_NS Registers
0x500A8000 SYSRTC0_NS size 0x1000 — SYSRTC0_NS Registers
0x500AC000 LCD_NS size 0x1000 — LCD_NS Registers
0x500B0000 KEYSCAN_NS size 0x1000 — KEYSCAN_NS Registers
0x500B4000 DMEM_NS size 0x1000 — DMEM_NS Registers
0x500C0000 LCDRF_NS size 0x1000 — LCDRF_NS Registers
0x500C4000 PFMXPPRF_NS size 0x1000 — PFMXPPRF_NS Registers
0x54000000 RADIOAES_NS size 0x1000 — RADIOAES_NS Registers
0x54008000 SMU_NS size 0x1000 — SMU_NS Registers
0x5400C000 SMU_NS_CFGNS size 0x1000 — SMU_NS_CFGNS Registers
0x59000000 LETIMER0_NS size 0x1000 — LETIMER0_NS Registers
0x59004000 IADC0_NS size 0x1000 — IADC0_NS Registers
0x59008000 ACMP0_NS size 0x1000 — ACMP0_NS Registers
0x5900C000 ACMP1_NS size 0x1000 — ACMP1_NS Registers
0x59020000 AMUXCP0_NS size 0x1000 — AMUXCP0_NS Registers
0x59024000 VDAC0_NS size 0x1000 — VDAC0_NS Registers
0x59030000 PCNT0_NS size 0x1000 — PCNT0_NS Registers
0x59038000 LESENSE_NS size 0x1000 — LESENSE_NS Registers
0x5A000000 HFRCOEM23_NS size 0x1000 — HFRCOEM23_NS Registers
0x5A004000 HFXO0_NS size 0x1000 — HFXO0_NS Registers
0x5B000000 I2C0_NS size 0x1000 — I2C0_NS Registers
0x5B004000 WDOG0_NS size 0x1000 — WDOG0_NS Registers
0x5B008000 WDOG1_NS size 0x1000 — WDOG1_NS Registers
0x5B010000 EUSART0_NS size 0x1000 — EUSART0_NS Registers
0x5C000000 SEMAILBOX_NS_HOST size 0x1000 — SEMAILBOX_NS_HOST Registers
0xA8004000 FRC_S size 0x1000 — FRC_S Registers
0xA800C000 AGC_S size 0x1000 — AGC_S Registers
0xA8010000 RFCRC_S size 0x1000 — RFCRC_S Registers
0xA8014000 MODEM_S size 0x1000 — MODEM_S Registers
0xA8018000 SYNTH_S size 0x1000 — SYNTH_S Registers
0xA801C000 PROTIMER_S size 0x1000 — PROTIMER_S Registers
0xA8020000 RAC_S size 0x1000 — RAC_S Registers
0xA8024000 RFSCRATCHPAD_S size 0x1000 — RFSCRATCHPAD_S Registers
0xA802C000 RFMAILBOX_S size 0x1000 — RFMAILBOX_S Registers
0xA8030000 RFECA0_S size 0x1000 — RFECA0_S Registers
0xA8034000 RFECA1_S size 0x1000 — RFECA1_S Registers
0xA8038000 ECAIFADC_S size 0x1000 — ECAIFADC_S Registers
0xAA000000 BUFC_S size 0x1000 — BUFC_S Registers
0xB8004000 FRC_NS size 0x1000 — FRC_NS Registers
0xB800C000 AGC_NS size 0x1000 — AGC_NS Registers
0xB8010000 RFCRC_NS size 0x1000 — RFCRC_NS Registers
0xB8014000 MODEM_NS size 0x1000 — MODEM_NS Registers
0xB8018000 SYNTH_NS size 0x1000 — SYNTH_NS Registers
0xB801C000 PROTIMER_NS size 0x1000 — PROTIMER_NS Registers
0xB8020000 RAC_NS size 0x1000 — RAC_NS Registers
0xB8024000 RFSCRATCHPAD_NS size 0x1000 — RFSCRATCHPAD_NS Registers
0xB802C000 RFMAILBOX_NS size 0x1000 — RFMAILBOX_NS Registers
0xB8030000 RFECA0_NS size 0x1000 — RFECA0_NS Registers
0xB8034000 RFECA1_NS size 0x1000 — RFECA1_NS Registers
0xB8038000 ECAIFADC_NS size 0x1000 — ECAIFADC_NS Registers
0xBA000000 BUFC_NS size 0x1000 — BUFC_NS Registers

## Interrupts
0 SMU_SECURE (SMU_S, SMU_S_CFGNS, SMU_NS, SMU_NS_CFGNS)
1 SMU_PRIVILEGED (SMU_S, SMU_S_CFGNS, SMU_NS, SMU_NS_CFGNS)
3 EMU (EMU_S, EMU_NS)
4 TIMER0 (TIMER0_S, TIMER0_NS)
5 TIMER1 (TIMER1_S, TIMER1_NS)
6 TIMER2 (TIMER2_S, TIMER2_NS)
7 TIMER3 (TIMER3_S, TIMER3_NS)
8 TIMER4 (TIMER4_S, TIMER4_NS)
9 USART0_RX (USART0_S, USART0_NS)
10 USART0_TX (USART0_S, USART0_NS)
11 EUSART0_RX (EUSART0_S, EUSART0_NS)
12 EUSART0_TX (EUSART0_S, EUSART0_NS)
13 EUSART1_RX (EUSART1_S, EUSART1_NS)
14 EUSART1_TX (EUSART1_S, EUSART1_NS)
15 EUSART2_RX (EUSART1_S, EUSART1_NS)
16 EUSART2_TX (EUSART1_S, EUSART1_NS)
17 ICACHE0 (ICACHE0_S, ICACHE0_NS)
18 BURTC (BURTC_S, BURTC_NS)
19 LETIMER0 (LETIMER0_S, LETIMER0_NS)
20 SYSCFG (SYSCFG_S_CFGNS, SYSCFG_S, SYSCFG_NS_CFGNS, SYSCFG_NS)
22 LDMA (LDMA_S, LDMA_NS)
23 LFXO (LFXO_S, LFXO_NS)
24 LFRCO (LFRCO_S, LFRCO_NS)
25 ULFRCO (ULFRCO_S, ULFRCO_NS)
26 GPIO_ODD (GPIO_S, GPIO_NS)
27 GPIO_EVEN (GPIO_S, GPIO_NS)
28 I2C0 (I2C0_S, I2C0_NS)
29 I2C1 (I2C1_S, I2C1_NS)
30 EMUDG (EMU_S, EMU_NS)
31 AGC (AGC_S, AGC_NS)
32 BUFC (BUFC_S, BUFC_NS)
33 FRC_PRI (FRC_S, FRC_NS)
34 FRC (FRC_S, FRC_NS)
35 MODEM (MODEM_S, MODEM_NS)
36 PROTIMER (PROTIMER_S, PROTIMER_NS)
37 RAC_RSM (RAC_S, RAC_NS)
38 RAC_SEQ (RAC_S, RAC_NS)
40 SYNTH (SYNTH_S, SYNTH_NS)
41 ACMP0 (ACMP0_S, ACMP0_NS)
42 ACMP1 (ACMP1_S, ACMP1_NS)
43 WDOG0 (WDOG0_S, WDOG0_NS)
44 WDOG1 (WDOG1_S, WDOG1_NS)
45 HFXO0 (HFXO0_S, HFXO0_NS)
46 HFRCO0 (HFRCO0_S, HFRCO0_NS)
47 HFRCOEM23 (HFRCOEM23_S, HFRCOEM23_NS)
48 CMU (CMU_S, CMU_NS)
49 AES (RADIOAES_S, RADIOAES_NS)
50 IADC (IADC0_S, IADC0_NS)
51 MSC (MSC_S, MSC_NS)
52 DPLL0 (DPLL0_S, DPLL0_NS)
55 VDAC (VDAC0_S, VDAC0_NS)
56 PCNT0 (PCNT0_S, PCNT0_NS)
57 SW0 (SYSCFG_S_CFGNS, SYSCFG_S, SYSCFG_NS_CFGNS, SYSCFG_NS)
58 SW1 (SYSCFG_S_CFGNS, SYSCFG_S, SYSCFG_NS_CFGNS, SYSCFG_NS)
59 SW2 (SYSCFG_S_CFGNS, SYSCFG_S, SYSCFG_NS_CFGNS, SYSCFG_NS)
60 SW3 (SYSCFG_S_CFGNS, SYSCFG_S, SYSCFG_NS_CFGNS, SYSCFG_NS)
67 SEMBRX (SEMAILBOX_S_HOST, SEMAILBOX_NS_HOST)
68 SEMBTX (SEMAILBOX_S_HOST, SEMAILBOX_NS_HOST)
72 LCD (LCD_S, LCD_NS)
73 KEYSCAN (KEYSCAN_S, KEYSCAN_NS)
74 RFECA0 (RFECA0_S, RFECA0_NS)
75 RFECA1 (RFECA1_S, RFECA1_NS)

## Further device data
name=Copyright 2018 Silicon Laboratories, Inc., ramBaseAddress=0x20000000, ramSize=0x00010000, ramAccessTypes=rwx, seqram_s_BaseAddress=0xA0000000, seqram_s_Size=0x00004000, seqram_s_AccessTypes=rwx, frcram_s_BaseAddress=0xA0004000, frcram_s_Size=0x00001000, frcram_s_AccessTypes=rwx, seqram_ns_BaseAddress=0xB0000000, seqram_ns_Size=0x00004000, seqram_ns_AccessTypes=rwx, frcram_ns_BaseAddress=0xB0004000, frcram_ns_Size=0x00001000, frcram_ns_AccessTypes=rwx
