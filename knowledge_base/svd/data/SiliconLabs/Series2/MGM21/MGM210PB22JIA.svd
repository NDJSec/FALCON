# MGM210PB22JIA register map
Vendor: Silicon Labs; Series: EFR32; File version: 2
Mighty Gecko Module, PCB, Vault Security, +10 dBm, 2.4 GHz, 1024/96 kB, -40 to +125 C, Chip antenna, FP
Registers are 32-bit, read-write, reset 0x0 unless marked. A register's access mark holds for its fields unless they carry their own. Offsets are from the block's base; lines under a group give offsets from that group; [hi:lo] are bit positions; {n}, {i} and the like mark numbered series; 'fields as' and 'values as' point back to an identical list; <NAME> marks a mode.

## Memory map
0x0FE08000 DEVINFO size 0x1000 — DEVINFO Registers
0x40004000 EMU_S size 0x1000 — EMU_S Registers
0x40008000 CMU_S size 0x1000 — CMU_S Registers
0x4000C000 HFXO0_S size 0x1000 — HFXO0_S Registers
0x40010000 HFRCO0_S size 0x1000 — HFRCO0_S Registers
0x40018000 FSRCO_S size 0x1000 — FSRCO_S Registers
0x4001C000 DPLL0_S size 0x1000 — DPLL0_S Registers
0x40020000 LFXO_S size 0x1000 — LFXO_S Registers
0x40024000 LFRCO_S size 0x1000 — LFRCO_S Registers
0x40028000 ULFRCO_S size 0x1000 — ULFRCO_S Registers
0x40030000 MSC_S size 0x1000 — MSC_S Registers
0x40034000 ICACHE0_S size 0x1000 — ICACHE0_S Registers
0x40038000 PRS_S size 0x1000 — PRS_S Registers
0x4003C000 GPIO_S size 0x1000 — GPIO_S Registers
0x40040000 LDMA_S size 0x1000 — LDMA_S Registers
0x40044000 LDMAXBAR_S size 0x1000 — LDMAXBAR_S Registers
0x40048000 TIMER0_S size 0x1000 — TIMER0_S Registers
0x4004C000 TIMER1_S size 0x1000 — TIMER1_S Registers
0x40050000 TIMER2_S size 0x1000 — TIMER2_S Registers
0x40054000 TIMER3_S size 0x1000 — TIMER3_S Registers
0x40058000 USART0_S size 0x1000 — USART0_S Registers
0x4005C000 USART1_S size 0x1000 — USART1_S Registers
0x40060000 USART2_S size 0x1000 — USART2_S Registers
0x40064000 BURTC_S size 0x1000 — BURTC_S Registers
0x40068000 I2C1_S size 0x1000 — I2C1_S Registers
0x4007C000 SYSCFG_S size 0x1000 — SYSCFG_S Registers
0x40080000 BURAM_S size 0x1000 — BURAM_S Registers
0x40088000 GPCRC_S size 0x1000 — GPCRC_S Registers
0x44000000 RADIOAES_S size 0x4000 — RADIOAES_S Registers
0x44004000 BUFC_S size 0x1000 — BUFC_S Registers
0x44008000 SMU_S size 0x1000 — SMU_S Registers
0x48000000 RTCC_S size 0x1000 — RTCC_S Registers
0x4A000000 LETIMER0_S size 0x1000 — LETIMER0_S Registers
0x4A004000 IADC0_S size 0x1000 — IADC0_S Registers
0x4A008000 ACMP0_S size 0x1000 — ACMP0_S Registers
0x4A00C000 ACMP1_S size 0x1000 — ACMP1_S Registers
0x4A010000 I2C0_S size 0x1000 — I2C0_S Registers
0x4A014000 HFRCOEM23_S size 0x1000 — HFRCOEM23_S Registers
0x4A018000 WDOG0_S size 0x1000 — WDOG0_S Registers
0x4A01C000 WDOG1_S size 0x1000 — WDOG1_S Registers
0x4A020000 AMUXCP0_S size 0x1000 — AMUXCP0_S Registers
0x4C000000 SEMAILBOX_S_HOST size 0x1000 — SEMAILBOX_S_HOST Registers
0x50004000 EMU_NS size 0x1000 — EMU_NS Registers
0x50008000 CMU_NS size 0x1000 — CMU_NS Registers
0x5000C000 HFXO0_NS size 0x1000 — HFXO0_NS Registers
0x50010000 HFRCO0_NS size 0x1000 — HFRCO0_NS Registers
0x50018000 FSRCO_NS size 0x1000 — FSRCO_NS Registers
0x5001C000 DPLL0_NS size 0x1000 — DPLL0_NS Registers
0x50020000 LFXO_NS size 0x1000 — LFXO_NS Registers
0x50024000 LFRCO_NS size 0x1000 — LFRCO_NS Registers
0x50028000 ULFRCO_NS size 0x1000 — ULFRCO_NS Registers
0x50030000 MSC_NS size 0x1000 — MSC_NS Registers
0x50034000 ICACHE0_NS size 0x1000 — ICACHE0_NS Registers
0x50038000 PRS_NS size 0x1000 — PRS_NS Registers
0x5003C000 GPIO_NS size 0x1000 — GPIO_NS Registers
0x50040000 LDMA_NS size 0x1000 — LDMA_NS Registers
0x50044000 LDMAXBAR_NS size 0x1000 — LDMAXBAR_NS Registers
0x50048000 TIMER0_NS size 0x1000 — TIMER0_NS Registers
0x5004C000 TIMER1_NS size 0x1000 — TIMER1_NS Registers
0x50050000 TIMER2_NS size 0x1000 — TIMER2_NS Registers
0x50054000 TIMER3_NS size 0x1000 — TIMER3_NS Registers
0x50058000 USART0_NS size 0x1000 — USART0_NS Registers
0x5005C000 USART1_NS size 0x1000 — USART1_NS Registers
0x50060000 USART2_NS size 0x1000 — USART2_NS Registers
0x50064000 BURTC_NS size 0x1000 — BURTC_NS Registers
0x50068000 I2C1_NS size 0x1000 — I2C1_NS Registers
0x5007C000 SYSCFG_NS size 0x1000 — SYSCFG_NS Registers
0x50080000 BURAM_NS size 0x1000 — BURAM_NS Registers
0x50088000 GPCRC_NS size 0x1000 — GPCRC_NS Registers
0x54000000 RADIOAES_NS size 0x4000 — RADIOAES_NS Registers
0x54004000 BUFC_NS size 0x1000 — BUFC_NS Registers
0x54008000 SMU_NS size 0x1000 — SMU_NS Registers
0x58000000 RTCC_NS size 0x1000 — RTCC_NS Registers
0x5A000000 LETIMER0_NS size 0x1000 — LETIMER0_NS Registers
0x5A004000 IADC0_NS size 0x1000 — IADC0_NS Registers
0x5A008000 ACMP0_NS size 0x1000 — ACMP0_NS Registers
0x5A00C000 ACMP1_NS size 0x1000 — ACMP1_NS Registers
0x5A010000 I2C0_NS size 0x1000 — I2C0_NS Registers
0x5A014000 HFRCOEM23_NS size 0x1000 — HFRCOEM23_NS Registers
0x5A018000 WDOG0_NS size 0x1000 — WDOG0_NS Registers
0x5A01C000 WDOG1_NS size 0x1000 — WDOG1_NS Registers
0x5A020000 AMUXCP0_NS size 0x1000 — AMUXCP0_NS Registers
0x5C000000 SEMAILBOX_NS_HOST size 0x1000 — SEMAILBOX_NS_HOST Registers
0xA8000000 PRORTC_S size 0x1000 — PRORTC_S Registers
0xA8004000 FRC_S size 0x1000 — FRC_S Registers
0xA800C000 AGC_S size 0x1000 — AGC_S Registers
0xA8010000 RFCRC_S size 0x1000 — RFCRC_S Registers
0xA8014000 MODEM_S size 0x1000 — MODEM_S Registers
0xA8018000 SYNTH_S size 0x1000 — SYNTH_S Registers
0xA801C000 PROTIMER_S size 0x1000 — PROTIMER_S Registers
0xA8020000 RAC_S size 0x1000 — RAC_S Registers
0xB8000000 PRORTC_NS size 0x1000 — PRORTC_NS Registers
0xB8004000 FRC_NS size 0x1000 — FRC_NS Registers
0xB800C000 AGC_NS size 0x1000 — AGC_NS Registers
0xB8010000 RFCRC_NS size 0x1000 — RFCRC_NS Registers
0xB8014000 MODEM_NS size 0x1000 — MODEM_NS Registers
0xB8018000 SYNTH_NS size 0x1000 — SYNTH_NS Registers
0xB801C000 PROTIMER_NS size 0x1000 — PROTIMER_NS Registers
0xB8020000 RAC_NS size 0x1000 — RAC_NS Registers

## Interrupts
3 SMU_SECURE (SMU_S, SMU_NS)
4 SMU_PRIVILEGED (SMU_S, SMU_NS)
5 EMU (EMU_S, EMU_NS)
6 TIMER0 (TIMER0_S, TIMER0_NS)
7 TIMER1 (TIMER1_S, TIMER1_NS)
8 TIMER2 (TIMER2_S, TIMER2_NS)
9 TIMER3 (TIMER3_S, TIMER3_NS)
10 RTCC (RTCC_S, RTCC_NS)
11 USART0_RX (USART0_S, USART0_NS)
12 USART0_TX (USART0_S, USART0_NS)
13 USART1_RX (USART1_S, USART1_NS)
14 USART1_TX (USART1_S, USART1_NS)
15 USART2_RX (USART2_S, USART2_NS)
16 USART2_TX (USART2_S, USART2_NS)
17 ICACHE0 (ICACHE0_S, ICACHE0_NS)
18 BURTC (BURTC_S, BURTC_NS)
19 LETIMER0 (LETIMER0_S, LETIMER0_NS)
20 SYSCFG (SYSCFG_S, SYSCFG_NS)
21 LDMA (LDMA_S, LDMA_NS)
22 LFXO (LFXO_S, LFXO_NS)
23 LFRCO (LFRCO_S, LFRCO_NS)
24 ULFRCO (ULFRCO_S, ULFRCO_NS)
25 GPIO_ODD (GPIO_S, GPIO_NS)
26 GPIO_EVEN (GPIO_S, GPIO_NS)
27 I2C0 (I2C0_S, I2C0_NS)
28 I2C1 (I2C1_S, I2C1_NS)
29 EMUDG (EMU_S, EMU_NS)
30 EMUSE (EMU_S, EMU_NS)
31 AGC (AGC_S, AGC_NS)
32 BUFC (BUFC_S, BUFC_NS)
33 FRC_PRI (FRC_S, FRC_NS)
34 FRC (FRC_S, FRC_NS)
35 MODEM (MODEM_S, MODEM_NS)
36 PROTIMER (PROTIMER_S, PROTIMER_NS)
37 RAC_RSM (RAC_S, RAC_NS)
38 RAC_SEQ (RAC_S, RAC_NS)
39 PRORTC (PRORTC_S, PRORTC_NS)
40 SYNTH (SYNTH_S, SYNTH_NS)
41 ACMP0 (ACMP0_S, ACMP0_NS)
42 ACMP1 (ACMP1_S, ACMP1_NS)
43 WDOG0 (WDOG0_S, WDOG0_NS)
44 WDOG1 (WDOG1_S, WDOG1_NS)
45 HFXO00 (HFXO0_S, HFXO0_NS)
46 HFRCO0 (HFRCO0_S, HFRCO0_NS)
47 HFRCOEM23 (HFRCOEM23_S, HFRCOEM23_NS)
48 CMU (CMU_S, CMU_NS)
49 AES (RADIOAES_S, RADIOAES_NS)
50 IADC (IADC0_S, IADC0_NS)
51 MSC (MSC_S, MSC_NS)
52 DPLL0 (DPLL0_S, DPLL0_NS)
53 SW0 (SYSCFG_S, SYSCFG_NS)
54 SW1 (SYSCFG_S, SYSCFG_NS)
55 SW2 (SYSCFG_S, SYSCFG_NS)
56 SW3 (SYSCFG_S, SYSCFG_NS)

## Further device data
name=Copyright 2018 Silicon Laboratories, Inc., flashBaseAddress=0x00000000, flashSize=0x00100000, flashAccessTypes=rx, userdataBaseAddress=0x0FE00000, userdataSize=0x00000400, userdataAccessTypes=rx, devinfoBaseAddress=0x0FE08000, devinfoSize=0x00000400, devinfoAccessTypes=rx, chipconfigBaseAddress=0x0FE0E000, chipconfigSize=0x00000400, chipconfigAccessTypes=rx, reservedBaseAddress=0x0FF00000, reservedSize=0x00100000, reservedAccessTypes=rx, ramBaseAddress=0x20000000, ramSize=0x00018000, ramAccessTypes=rwx, seqram_s_BaseAddress=0xA0000000, seqram_s_Size=0x00002000, seqram_s_AccessTypes=rwx, frcram_s_BaseAddress=0xA0002000, frcram_s_Size=0x00001000, frcram_s_AccessTypes=rwx, seqram_ns_BaseAddress=0xB0000000, seqram_ns_Size=0x00002000, seqram_ns_AccessTypes=rwx, frcram_ns_BaseAddress=0xB0002000, frcram_ns_Size=0x00001000, frcram_ns_AccessTypes=rwx
