# R7FA6T2BD register map
Vendor: Renesas Electronics Corporation; Series: RA6; File version: 1.30.01
Arm Cortex-M33 based Microcontroller RA6T2 group
CPU: CM33 r0p4, little endian, MPU, FPU, VTOR, 4 interrupt priority bits, 96 interrupts
Registers are 32-bit, read-write, reset 0x0 unless marked. A register's access mark holds for its fields unless they carry their own. Offsets are from the block's base; lines under a group give offsets from that group; [hi:lo] are bit positions; {n}, {i} and the like mark numbered series; 'fields as' and 'values as' point back to an identical list; <NAME> marks a mode.

## Memory map
0x40000000 RMPU blocks up to offset 0x288 — Renesas Memory Protection Unit
0x40000E00 TZF blocks up to offset 0x6 — TrustZone Filter
0x40002000 SRAM blocks up to offset 0xD9 — SRAM Control
0x40003000 BUS blocks up to offset 0x1A38 — BUS Control
{0x40005000+0x40*n} DMAC{n} blocks up to offset 0x30 (n=0..7) — Direct memory access controller {n}
0x40005200 DMA blocks up to offset 0x44 — DMAC Module Activation
0x40005400 DTC blocks up to offset 0x24 — Data Transfer Controller
0x40006000 ICU blocks up to offset 0x480 — Interrupt Controller
0x40007000 CACHE blocks up to offset 0x208
0x40008000 CPSCU blocks up to offset 0x1B4 — CPU System Security Control Unit
0x4001B000 DBG blocks up to offset 0x14 — Debug Function
0x4001C100 FCACHE blocks up to offset 0x42 — Flash Cache
0x4001E000 SYSC blocks up to offset 0x493 — System Control
0x4001F000 PORT0 blocks up to offset 0xC — Port 0 Control Registers
0x4001F040 PORT2 blocks up to offset 0xC — Port 2 Control Registers
0x4001F140 PORTA blocks up to offset 0xC — Port A Control Registers
0x4001F160 PORTB size 0x10 — Port B Control Registers
0x4001F180 PORTC size 0x10 — Port C Control Registers
0x4001F1A0 PORTD size 0x10 — Port D Control Registers
0x4001F1C0 PORTE size 0x10 — Port E Control Registers
0x4001F800 PFS_B blocks up to offset 0x56A — Pmn Pin Function Control Register
0x40020000 IIRFA blocks up to offset 0x818 — IIR filter accelerator
0x40021000 TFU blocks up to offset 0x20 — Trigonometric Function Unit
0x40082000 ELC_B blocks up to offset 0xE8 — Event Link Controller
0x40083200 IWDT blocks up to offset 0x6 — Independent Watchdog Timer
0x40083400 WDT blocks up to offset 0x9 — Watchdog Timer
0x40083600 CAC blocks up to offset 0xC — Clock Frequency Accuracy Measurement Circuit
0x40084000 MSTP size 0x14 — Module Stop Control
0x40085000 KINT blocks up to offset 0x9 — Key Interrupt Function
0x4008A000 POEG blocks up to offset 0x346 — Port Output Enable for GPT
0x400B0000 CANFD_B blocks up to offset 0x17C8 — CANFD Module Control
0x400E0000 PSCU blocks up to offset 0x30 — Peripheral Security Control Unit
0x400E8000 AGTW_B0 blocks up to offset 0x14 — Low Power Asynchronous General Purpose Timer 0
0x400E8100 AGTW_B1 blocks up to offset 0x14 — Low Power Asynchronous General Purpose Timer 1
0x400F3000 TSN size 0x1 — Temperature Sensor
0x400F4000 ACMPHS0 blocks up to offset 0x11 — High-Speed Analog Comparator 0
0x400F4100 ACMPHS1 blocks up to offset 0x11 — High-Speed Analog Comparator 1
0x400F4200 ACMPHS2 blocks up to offset 0x11 — High-Speed Analog Comparator 2
0x400F4300 ACMPHS3 blocks up to offset 0x11 — High-Speed Analog Comparator 3
0x40108000 CRC blocks up to offset 0xE — Cyclic Redundancy Check
0x40109000 DOC_B blocks up to offset 0x18 — Data Operation Circuit
0x40118000 SCI_B0 blocks up to offset 0x7C — Serial Communication Interface 0
0x40118100 SCI_B1 blocks up to offset 0x7C — Serial Communication Interface 1
0x40118200 SCI_B2 blocks up to offset 0x7C — Serial Communication Interface 2
0x40118300 SCI_B3 blocks up to offset 0x7C — Serial Communication Interface 3
0x40118400 SCI_B4 blocks up to offset 0x7C — Serial Communication Interface 4
0x40118900 SCI_B9 blocks up to offset 0x7C — Serial Communication Interface 9
0x4011A000 SPI_B0 blocks up to offset 0x70 — Serial Peripheral Interface 0
0x4011A100 SPI_B1 blocks up to offset 0x70 — Serial Peripheral Interface 1
0x4011F000 IIC_B0 blocks up to offset 0x3D0 — Inter-Integrated Circuit 0
0x4011F098 IIC0WU_B blocks up to offset 0x184 — Inter-Integrated Circuit 0 Wake-up Unit
0x4011F400 IIC_B1 blocks up to offset 0x3D0 — Inter-Integrated Circuit 1
0x4012F200 ECCMB blocks up to offset 0x14 — CANFD ECC Module
{0x40155000+0x100*n} GPT{n} blocks up to offset 0xF0 (n=320..329) — General PWM 32-bit Timer {n-320}
0x40169A00 GPT_OPS size 0x4 — Output Phase Switching Controller
0x40169B00 GPT_GTCLK size 0x4 — GTCLK
0x4016A000 PDG blocks up to offset 0x3A — PWM Delay Generation Circuit
0x40170000 ADC_B blocks up to offset 0x1224 — 12-bit A/D Converter
0x40172000 DAC120 blocks up to offset 0x1D — 12-bit D/A converter 0
0x40172100 DAC121 blocks up to offset 0x1D — 12-bit D/A converter 1
0x407FB000 TSD blocks up to offset 0x180 — Temperature Sensor Calibration Data
0x407FC000 FLAD blocks up to offset 0x41 — Data Flash
0x407FE000 FACI blocks up to offset 0xEA — Flash Application Command Interface

## Interrupts
{n} IEL{n} (ICU) (n=0..95) — ICU Interrupt {n}

## Licence text in the file
This software is supplied by Renesas Electronics Corporation and is only intended for use with Renesas products. No other uses are authorized. This software is owned by. Renesas Electronics Corporation and is protected under all applicable laws, including copyright laws. . THIS SOFTWARE IS PROVIDED "AS IS" AND RENESAS MAKES NO WARRANTIES REGARDING. THIS SOFTWARE, WHETHER EXPRESS, IMPLIED OR STATUTORY, INCLUDING BUT NOT LIMITED TO. WARRANTIES OF MERCHANTABILITY, FITNESS FOR A PARTICULAR PURPOSE AND NON-INFRINGEMENT. ALL SUCH WARRANTIES ARE EXPRESSLY DISCLAIMED. TO THE MAXIMUM EXTENT PERMITTED NOT. PROHIBITED BY LAW, NEITHER RENESAS ELECTRONICS CORPORATION NOR ANY OF ITS AFFILIATED. COMPANIES SHALL BE LIABLE FOR ANY DIRECT, INDIRECT, SPECIAL, INCIDENTAL OR CONSEQUENTIAL. DAMAGES FOR ANY REASON RELATED TO THIS SOFTWARE, EVEN IF RENESAS OR ITS AFFILIATES HAVE. BEEN ADVISED OF THE POSSIBILITY OF SUCH DAMAGES. . Renesas reserves the right, without notice, to make changes to this software and to discontinue the availability of this software. By using this software, you agree to the additional terms and conditions found by accessing the following link: http://www.renesas.com/disclaimer
