# MKV58F24 register map
Vendor: Freescale Semiconductor, Inc.; Series: Kinetis_V; File version: 1.6
CPU: CM7 r0p1, little endian, no MPU, FPU, VTOR, 4 interrupt priority bits
Registers are 32-bit, read-write, reset 0x0 unless marked. A register's access mark holds for its fields unless they carry their own. Offsets are from the block's base; [hi:lo] are bit positions; {n}, {i} and the like mark numbered series.

## NVIC — Nested Vectored Interrupt Controller
Base 0xE000E100
{0x0+4i} NVICISER{i} (i=0..3) — Interrupt Set Enable Register n
  [31:0] SETENA — Interrupt set enable bits
{0x80+4i} NVICICER{i} (i=0..3) — Interrupt Clear Enable Register n
  [31:0] CLRENA — Interrupt clear-enable bits
{0x100+4i} NVICISPR{i} (i=0..3) — Interrupt Set Pending Register n
  [31:0] SETPEND — Interrupt set-pending bits
{0x180+4i} NVICICPR{i} (i=0..3) — Interrupt Clear Pending Register n
  [31:0] CLRPEND — Interrupt clear-pending bits
{0x200+4i} NVICIABR{i} (i=0..3) — Interrupt Active bit Register n
  [31:0] ACTIVE — Interrupt active flags
{0x300+i} NVICIP{i} 8-bit (i=0..15) — Interrupt Priority Register {i}
  [7:4] PRI{i} — Priority of the INT_DMA{i}_DMA{i+16} interrupt {i}
0x310 NVICIP16 8-bit — Interrupt Priority Register 16
  [7:4] PRI16 — Priority of the INT_DMA_Error interrupt 16
0x311 NVICIP17 8-bit — Interrupt Priority Register 17
  [7:4] PRI17 — Priority of the INT_MCM interrupt 17
0x312 NVICIP18 8-bit — Interrupt Priority Register 18
  [7:4] PRI18 — Priority of the INT_FTFE interrupt 18
0x313 NVICIP19 8-bit — Interrupt Priority Register 19
  [7:4] PRI19 — Priority of the INT_Read_Collision interrupt 19
0x314 NVICIP20 8-bit — Interrupt Priority Register 20
  [7:4] PRI20 — Priority of the INT_PMC interrupt 20
0x315 NVICIP21 8-bit — Interrupt Priority Register 21
  [7:4] PRI21 — Priority of the INT_LLWU interrupt 21
0x316 NVICIP22 8-bit — Interrupt Priority Register 22
  [7:4] PRI22 — Priority of the INT_WDOG_EWM interrupt 22
0x317 NVICIP23 8-bit — Interrupt Priority Register 23
  [7:4] PRI23 — Priority of the INT_TRNG0 interrupt 23
0x318 NVICIP24 8-bit — Interrupt Priority Register 24
  [7:4] PRI24 — Priority of the INT_I2C0 interrupt 24
0x319 NVICIP25 8-bit — Interrupt Priority Register 25
  [7:4] PRI25 — Priority of the INT_I2C1 interrupt 25
0x31A NVICIP26 8-bit — Interrupt Priority Register 26
  [7:4] PRI26 — Priority of the INT_SPI0 interrupt 26
0x31B NVICIP27 8-bit — Interrupt Priority Register 27
  [7:4] PRI27 — Priority of the INT_SPI1 interrupt 27
0x31C NVICIP28 8-bit — Interrupt Priority Register 28
  [7:4] PRI28 — Priority of the INT_UART5_RX_TX interrupt 28
0x31D NVICIP29 8-bit — Interrupt Priority Register 29
  [7:4] PRI29 — Priority of the INT_UART5_ERR interrupt 29
0x31E NVICIP30 8-bit — Interrupt Priority Register 30
  [7:4] PRI30 — Priority of interrupt 30
0x31F NVICIP31 8-bit — Interrupt Priority Register 31
  [7:4] PRI31 — Priority of the INT_UART0_RX_TX interrupt 31
0x320 NVICIP32 8-bit — Interrupt Priority Register 32
  [7:4] PRI32 — Priority of the INT_UART0_ERR interrupt 32
0x321 NVICIP33 8-bit — Interrupt Priority Register 33
  [7:4] PRI33 — Priority of the INT_UART1_RX_TX interrupt 33
0x322 NVICIP34 8-bit — Interrupt Priority Register 34
  [7:4] PRI34 — Priority of the INT_UART1_ERR interrupt 34
0x323 NVICIP35 8-bit — Interrupt Priority Register 35
  [7:4] PRI35 — Priority of the INT_UART2_RX_TX interrupt 35
0x324 NVICIP36 8-bit — Interrupt Priority Register 36
  [7:4] PRI36 — Priority of the INT_UART2_ERR interrupt 36
0x325 NVICIP37 8-bit — Interrupt Priority Register 37
  [7:4] PRI37 — Priority of the INT_ADC0 interrupt 37
0x326 NVICIP38 8-bit — Interrupt Priority Register 38
  [7:4] PRI38 — Priority of the INT_HSADC_ERR interrupt 38
0x327 NVICIP39 8-bit — Interrupt Priority Register 39
  [7:4] PRI39 — Priority of the INT_HSADC0_CCA interrupt 39
0x328 NVICIP40 8-bit — Interrupt Priority Register 40
  [7:4] PRI40 — Priority of the INT_CMP0 interrupt 40
0x329 NVICIP41 8-bit — Interrupt Priority Register 41
  [7:4] PRI41 — Priority of the INT_CMP1 interrupt 41
0x32A NVICIP42 8-bit — Interrupt Priority Register 42
  [7:4] PRI42 — Priority of the INT_FTM0 interrupt 42
0x32B NVICIP43 8-bit — Interrupt Priority Register 43
  [7:4] PRI43 — Priority of the INT_FTM1 interrupt 43
0x32C NVICIP44 8-bit — Interrupt Priority Register 44
  [7:4] PRI44 — Priority of the INT_UART3_RX_TX interrupt 44
0x32D NVICIP45 8-bit — Interrupt Priority Register 45
  [7:4] PRI45 — Priority of the INT_UART3_ERR interrupt 45
0x32E NVICIP46 8-bit — Interrupt Priority Register 46
  [7:4] PRI46 — Priority of the INT_UART4_RX_TX interrupt 46
0x32F NVICIP47 8-bit — Interrupt Priority Register 47
  [7:4] PRI47 — Priority of the INT_UART4_ERR interrupt 47
{0x300+i} NVICIP{i} 8-bit (i=48..51) — Interrupt Priority Register {i}
  [7:4] PRI{i} — Priority of the INT_PIT{i-48} interrupt {i}
0x334 NVICIP52 8-bit — Interrupt Priority Register 52
  [7:4] PRI52 — Priority of the INT_PDB0 interrupt 52
0x335 NVICIP53 8-bit — Interrupt Priority Register 53
  [7:4] PRI53 — Priority of the INT_FTM2 interrupt 53
0x336 NVICIP54 8-bit — Interrupt Priority Register 54
  [7:4] PRI54 — Priority of the INT_XBARA interrupt 54
0x337 NVICIP55 8-bit — Interrupt Priority Register 55
  [7:4] PRI55 — Priority of the INT_PDB1 interrupt 55
0x338 NVICIP56 8-bit — Interrupt Priority Register 56
  [7:4] PRI56 — Priority of the INT_DAC0 interrupt 56
0x339 NVICIP57 8-bit — Interrupt Priority Register 57
  [7:4] PRI57 — Priority of the INT_MCG interrupt 57
0x33A NVICIP58 8-bit — Interrupt Priority Register 58
  [7:4] PRI58 — Priority of the INT_LPTMR0 interrupt 58
0x33B NVICIP59 8-bit — Interrupt Priority Register 59
  [7:4] PRI59 — Priority of the INT_PORTA interrupt 59
0x33C NVICIP60 8-bit — Interrupt Priority Register 60
  [7:4] PRI60 — Priority of the INT_PORTB interrupt 60
0x33D NVICIP61 8-bit — Interrupt Priority Register 61
  [7:4] PRI61 — Priority of the INT_PORTC interrupt 61
0x33E NVICIP62 8-bit — Interrupt Priority Register 62
  [7:4] PRI62 — Priority of the INT_PORTD interrupt 62
0x33F NVICIP63 8-bit — Interrupt Priority Register 63
  [7:4] PRI63 — Priority of the INT_PORTE interrupt 63
0x340 NVICIP64 8-bit — Interrupt Priority Register 64
  [7:4] PRI64 — Priority of the INT_SWI interrupt 64
0x341 NVICIP65 8-bit — Interrupt Priority Register 65
  [7:4] PRI65 — Priority of the INT_SPI2 interrupt 65
0x342 NVICIP66 8-bit — Interrupt Priority Register 66
  [7:4] PRI66 — Priority of the INT_ENC_COMPARE interrupt 66
0x343 NVICIP67 8-bit — Interrupt Priority Register 67
  [7:4] PRI67 — Priority of the INT_ENC_HOME interrupt 67
0x344 NVICIP68 8-bit — Interrupt Priority Register 68
  [7:4] PRI68 — Priority of the INT_ENC_WDOG_SAB interrupt 68
0x345 NVICIP69 8-bit — Interrupt Priority Register 69
  [7:4] PRI69 — Priority of the INT_ENC_INDEX interrupt 69
0x346 NVICIP70 8-bit — Interrupt Priority Register 70
  [7:4] PRI70 — Priority of the INT_CMP2 interrupt 70
0x347 NVICIP71 8-bit — Interrupt Priority Register 71
  [7:4] PRI71 — Priority of the INT_FTM3 interrupt 71
0x348 NVICIP72 8-bit — Interrupt Priority Register 72
  [7:4] PRI72 — Priority of interrupt 72
0x349 NVICIP73 8-bit — Interrupt Priority Register 73
  [7:4] PRI73 — Priority of the INT_HSADC0_CCB interrupt 73
0x34A NVICIP74 8-bit — Interrupt Priority Register 74
  [7:4] PRI74 — Priority of the INT_HSADC1_CCA interrupt 74
0x34B NVICIP75 8-bit — Interrupt Priority Register 75
  [7:4] PRI75 — Priority of the INT_CAN0_ORed_Message_buffer interrupt 75
0x34C NVICIP76 8-bit — Interrupt Priority Register 76
  [7:4] PRI76 — Priority of the INT_CAN0_Bus_Off interrupt 76
0x34D NVICIP77 8-bit — Interrupt Priority Register 77
  [7:4] PRI77 — Priority of the INT_CAN0_Error interrupt 77
0x34E NVICIP78 8-bit — Interrupt Priority Register 78
  [7:4] PRI78 — Priority of the INT_CAN0_Tx_Warning interrupt 78
0x34F NVICIP79 8-bit — Interrupt Priority Register 79
  [7:4] PRI79 — Priority of the INT_CAN0_Rx_Warning interrupt 79
0x350 NVICIP80 8-bit — Interrupt Priority Register 80
  [7:4] PRI80 — Priority of the INT_CAN0_Wake_Up interrupt 80
0x351 NVICIP81 8-bit — Interrupt Priority Register 81
  [7:4] PRI81 — Priority of the INT_PWM0_CMP0 interrupt 81
0x352 NVICIP82 8-bit — Interrupt Priority Register 82
  [7:4] PRI82 — Priority of the INT_PWM0_RELOAD0 interrupt 82
0x353 NVICIP83 8-bit — Interrupt Priority Register 83
  [7:4] PRI83 — Priority of the INT_PWM0_CMP1 interrupt 83
0x354 NVICIP84 8-bit — Interrupt Priority Register 84
  [7:4] PRI84 — Priority of the INT_PWM0_RELOAD1 interrupt 84
0x355 NVICIP85 8-bit — Interrupt Priority Register 85
  [7:4] PRI85 — Priority of the INT_PWM0_CMP2 interrupt 85
0x356 NVICIP86 8-bit — Interrupt Priority Register 86
  [7:4] PRI86 — Priority of the INT_PWM0_RELOAD2 interrupt 86
0x357 NVICIP87 8-bit — Interrupt Priority Register 87
  [7:4] PRI87 — Priority of the INT_PWM0_CMP3 interrupt 87
0x358 NVICIP88 8-bit — Interrupt Priority Register 88
  [7:4] PRI88 — Priority of the INT_PWM0_RELOAD3 interrupt 88
0x359 NVICIP89 8-bit — Interrupt Priority Register 89
  [7:4] PRI89 — Priority of the INT_PWM0_CAP interrupt 89
0x35A NVICIP90 8-bit — Interrupt Priority Register 90
  [7:4] PRI90 — Priority of the INT_PWM0_RERR interrupt 90
0x35B NVICIP91 8-bit — Interrupt Priority Register 91
  [7:4] PRI91 — Priority of the INT_PWM0_FAULT interrupt 91
0x35C NVICIP92 8-bit — Interrupt Priority Register 92
  [7:4] PRI92 — Priority of the INT_CMP3 interrupt 92
0x35D NVICIP93 8-bit — Interrupt Priority Register 93
  [7:4] PRI93 — Priority of the INT_HSADC1_CCB interrupt 93
0x35E NVICIP94 8-bit — Interrupt Priority Register 94
  [7:4] PRI94 — Priority of the INT_CAN1_ORed_Message_buffer interrupt 94
0x35F NVICIP95 8-bit — Interrupt Priority Register 95
  [7:4] PRI95 — Priority of the INT_CAN1_Bus_Off interrupt 95
0x360 NVICIP96 8-bit — Interrupt Priority Register 96
  [7:4] PRI96 — Priority of the INT_CAN1_Error interrupt 96
0x361 NVICIP97 8-bit — Interrupt Priority Register 97
  [7:4] PRI97 — Priority of the INT_CAN1_Tx_Warning interrupt 97
0x362 NVICIP98 8-bit — Interrupt Priority Register 98
  [7:4] PRI98 — Priority of the INT_CAN1_Rx_Warning interrupt 98
0x363 NVICIP99 8-bit — Interrupt Priority Register 99
  [7:4] PRI99 — Priority of the INT_CAN1_Wake_Up interrupt 99
0x364 NVICIP100 8-bit — Interrupt Priority Register 100
  [7:4] PRI100 — Priority of the INT_ENET_1588_Timer interrupt 100
0x365 NVICIP101 8-bit — Interrupt Priority Register 101
  [7:4] PRI101 — Priority of the INT_ENET_Transmit interrupt 101
0x366 NVICIP102 8-bit — Interrupt Priority Register 102
  [7:4] PRI102 — Priority of the INT_ENET_Receive interrupt 102
0x367 NVICIP103 8-bit — Interrupt Priority Register 103
  [7:4] PRI103 — Priority of the INT_ENET_Error interrupt 103
0x368 NVICIP104 8-bit — Interrupt Priority Register 104
  [7:4] PRI104 — Priority of the INT_PWM1_CMP0 interrupt 104
0x369 NVICIP105 8-bit — Interrupt Priority Register 105
  [7:4] PRI105 — Priority of the INT_PWM1_RELOAD0 interrupt 105
0x36A NVICIP106 8-bit — Interrupt Priority Register 106
  [7:4] PRI106 — Priority of the INT_PWM1_CMP1 interrupt 106
0x36B NVICIP107 8-bit — Interrupt Priority Register 107
  [7:4] PRI107 — Priority of the INT_PWM1_RELOAD1 interrupt 107
0x36C NVICIP108 8-bit — Interrupt Priority Register 108
  [7:4] PRI108 — Priority of the INT_PWM1_CMP2 interrupt 108
0x36D NVICIP109 8-bit — Interrupt Priority Register 109
  [7:4] PRI109 — Priority of the INT_PWM1_RELOAD2 interrupt 109
0x36E NVICIP110 8-bit — Interrupt Priority Register 110
  [7:4] PRI110 — Priority of the INT_PWM1_CMP3 interrupt 110
0x36F NVICIP111 8-bit — Interrupt Priority Register 111
  [7:4] PRI111 — Priority of the INT_PWM1_RELOAD3 interrupt 111
0x370 NVICIP112 8-bit — Interrupt Priority Register 112
  [7:4] PRI112 — Priority of the INT_PWM1_CAP interrupt 112
0x371 NVICIP113 8-bit — Interrupt Priority Register 113
  [7:4] PRI113 — Priority of the INT_PWM1_RERR interrupt 113
0x372 NVICIP114 8-bit — Interrupt Priority Register 114
  [7:4] PRI114 — Priority of the INT_PWM1_FAULT interrupt 114
0x373 NVICIP115 8-bit — Interrupt Priority Register 115
  [7:4] PRI115 — Priority of the INT_CAN2_ORed_Message_buffer interrupt 115
0x374 NVICIP116 8-bit — Interrupt Priority Register 116
  [7:4] PRI116 — Priority of the INT_CAN2_Bus_Off interrupt 116
0x375 NVICIP117 8-bit — Interrupt Priority Register 117
  [7:4] PRI117 — Priority of the INT_CAN2_Error interrupt 117
0x376 NVICIP118 8-bit — Interrupt Priority Register 118
  [7:4] PRI118 — Priority of the INT_CAN2_Tx_Warning interrupt 118
0x377 NVICIP119 8-bit — Interrupt Priority Register 119
  [7:4] PRI119 — Priority of the INT_CAN2_Rx_Warning interrupt 119
0x378 NVICIP120 8-bit — Interrupt Priority Register 120
  [7:4] PRI120 — Priority of the INT_CAN2_Wake_Up interrupt 120
0xE00 NVICSTIR — Software Trigger Interrupt Register
  [8:0] INTID — Interrupt ID of the interrupt to trigger, in the range 0-239. For example, a value of 0x03 specifies interrupt IRQ3.
