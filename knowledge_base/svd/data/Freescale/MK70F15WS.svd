# MK70F15WS register map
File version: 1.6
MK70F15WS Freescale Microcontroller
Registers are 32-bit, read-write, reset 0x0 unless marked. A register's access mark holds for its fields unless they carry their own. Offsets are from the block's base; lines under a group give offsets from that group; [hi:lo] are bit positions; {n}, {i} and the like mark numbered series; 'fields as' and 'values as' point back to an identical list; <NAME> marks a mode.

## Memory map
0x00000400 FTFE_FlashConfig size 0x10 — Flash configuration field
0x40000000 AIPS0 size 0x70 — AIPS-Lite Bridge
0x40004000 AXBS size 0xF04 — Crossbar switch
0x40008000 DMA size 0x1400 — Enhanced direct memory access controller
0x4000C000 FB size 0x64 — FlexBus external bus interface
0x4000D000 MPU size 0x840 — Memory protection unit
0x4001F000 FMC size 0x300 — Flash Memory Controller
0x40020000 FTFE size 0x18 — Flash Memory Interface
0x40021000 DMAMUX0 size 0x10 — DMA channel multiplexor
0x40022000 DMAMUX1 size 0x10 — DMA channel multiplexor
0x40024000 CAN0 size 0x8C0 — Flex Controller Area Network module
0x4002C000 SPI0 size 0x8C — Deserial Serial Peripheral Interface
0x4002D000 SPI1 size 0x8C — Deserial Serial Peripheral Interface
0x4002F000 I2S0 size 0x108 — Inter-IC Sound / Synchronous Audio Interface
0x40032000 CRC size 0xC — Cyclic Redundancy Check
0x40034000 USBHS size 0x204 — USB HS/FS/LS OTG Controller
0x40035000 USBDCD size 0x1C — USB Device Charger Detection module
0x40036000 PDB0 size 0x1A4 — Programmable Delay Block
0x40037000 PIT size 0x140 — Periodic Interrupt Timer
0x40038000 FTM0 size 0x9C — FlexTimer Module
0x40039000 FTM1 size 0x9C — FlexTimer Module
0x4003B000 ADC0 size 0x70 — Analog-to-Digital Converter
0x4003C000 ADC2 size 0x70 — Analog-to-Digital Converter
0x4003D000 RTC size 0x808 — Secure Real Time Clock
0x4003E000 RFVBAT size 0x20 — VBAT register file
0x40040000 LPTMR0 size 0x10 — Low Power Timer
0x40041000 RFSYS size 0x20 — System register file
0x40042000 DRY blocks up to offset 0x1808 — Tamper Detect and Secure Key Storage
0x40045000 TSI0 size 0x124 — Touch Sensing Input
0x40047000 SIM size 0x1070 — System Integration Module
0x40049000 PORTA size 0xCC — Pin Control and Interrupts
0x4004A000 PORTB size 0xCC — Pin Control and Interrupts
0x4004B000 PORTC size 0xCC — Pin Control and Interrupts
0x4004C000 PORTD size 0xCC — Pin Control and Interrupts
0x4004D000 PORTE size 0xCC — Pin Control and Interrupts
0x4004E000 PORTF size 0xCC — Pin Control and Interrupts
0x40052000 WDOG size 0x18 — Generation 2008 Watchdog Timer
0x40061000 EWM size 0x4 — External Watchdog Monitor
0x40062000 CMT size 0xC — Carrier Modulator Transmitter
0x40064000 MCG size 0x13 — Multipurpose Clock Generator module
0x40065000 OSC0 size 0x1 — Oscillator
0x40066000 I2C0 size 0xC — Inter-Integrated Circuit
0x40067000 I2C1 size 0xC — Inter-Integrated Circuit
0x4006A000 UART0 size 0x32 — Serial Communication Interface
0x4006B000 UART1 size 0x20 — Serial Communication Interface
0x4006C000 UART2 size 0x17 — Serial Communication Interface
0x4006D000 UART3 size 0x17 — Serial Communication Interface
0x40072000 USB0 size 0x115 — Universal Serial Bus, OTG Capable Controller
0x40073000 CMP0 size 0x6 — High-Speed Comparator (CMP), Voltage Reference (VREF) Digital-to-Analog Converter (DAC), and Analog Mux (ANMUX)
0x40073008 CMP1 size 0x6 — High-Speed Comparator (CMP), Voltage Reference (VREF) Digital-to-Analog Converter (DAC), and Analog Mux (ANMUX)
0x40073010 CMP2 size 0x6 — High-Speed Comparator (CMP), Voltage Reference (VREF) Digital-to-Analog Converter (DAC), and Analog Mux (ANMUX)
0x40073018 CMP3 size 0x6 — High-Speed Comparator (CMP), Voltage Reference (VREF) Digital-to-Analog Converter (DAC), and Analog Mux (ANMUX)
0x40074000 VREF size 0x2 — Voltage Reference
0x4007C000 LLWU size 0xB — Low leakage wakeup unit
0x4007D000 PMC size 0x3 — Power Management Controller
0x4007E000 SMC size 0x4 — System Mode Controller
0x4007F000 RCM size 0x8 — Reset Control Module
0x40080000 AIPS1 size 0x70 — AIPS-Lite Bridge
0x400A0000 RNG size 0x10 — Random Number Generator Accelerator
0x400A4000 CAN1 size 0x8C0 — Flex Controller Area Network module
0x400A8000 NFC blocks up to offset 0x3F3C — NAND flash controller
0x400AC000 SPI2 size 0x8C — Deserial Serial Peripheral Interface
0x400AE000 DDR size 0x1B0 — DRAM Controller
0x400AF000 I2S1 size 0x108 — Inter-IC Sound / Synchronous Audio Interface
0x400B1000 SDHC size 0x100 — Secured Digital Host Controller
0x400B6000 LCDC size 0x88 — Liquid Crystal Display Controller
0x400B8000 FTM2 size 0x9C — FlexTimer Module
0x400B9000 FTM3 size 0x9C — FlexTimer Module
0x400BB000 ADC1 size 0x70 — Analog-to-Digital Converter
0x400BC000 ADC3 size 0x70 — Analog-to-Digital Converter
0x400C0000 ENET blocks up to offset 0x628 — Ethernet MAC-NET Core
0x400CC000 DAC0 size 0x24 — 12-Bit Digital-to-Analog Converter
0x400CD000 DAC1 size 0x24 — 12-Bit Digital-to-Analog Converter
0x400E5000 OSC1 size 0x1 — Oscillator
0x400EA000 UART4 size 0x17 — Serial Communication Interface
0x400EB000 UART5 size 0x17 — Serial Communication Interface
0x400FF000 PTA size 0x18 — General Purpose Input/Output
0x400FF040 PTB size 0x18 — General Purpose Input/Output
0x400FF080 PTC size 0x18 — General Purpose Input/Output
0x400FF0C0 PTD size 0x18 — General Purpose Input/Output
0x400FF100 PTE size 0x18 — General Purpose Input/Output
0x400FF140 PTF size 0x18 — General Purpose Input/Output
0xE0080000 MCM blocks up to offset 0x34 — Core Platform Miscellaneous Control Module
0xE0081000 CAU size 0xB6C — Memory Mapped Cryptographic Acceleration Unit (MMCAU)
0xE0082000 LMEM size 0x824 — Local Memory Controller

## Interrupts
{n} INT_DMA{n}_DMA{n+16} (DMA) (n=0..15)
16 INT_DMA_Error (DMA)
18 INT_FTFE (FTFE)
19 INT_Read_Collision (FTFE)
20 INT_LVD_LVW (PMC)
21 INT_LLW (LLWU)
22 INT_Watchdog (WDOG, EWM)
23 INT_RNG (RNG)
24 INT_I2C0 (I2C0)
25 INT_I2C1 (I2C1)
26 INT_SPI0 (SPI0)
27 INT_SPI1 (SPI1)
28 INT_SPI2 (SPI2)
29 INT_CAN0_ORed_Message_buffer (CAN0)
30 INT_CAN0_Bus_Off (CAN0)
31 INT_CAN0_Error (CAN0)
32 INT_CAN0_Tx_Warning (CAN0)
33 INT_CAN0_Rx_Warning (CAN0)
34 INT_CAN0_Wake_Up (CAN0)
35 INT_I2S0_Tx (I2S0)
36 INT_I2S0_Rx (I2S0)
37 INT_CAN1_ORed_Message_buffer (CAN1)
38 INT_CAN1_Bus_Off (CAN1)
39 INT_CAN1_Error (CAN1)
40 INT_CAN1_Tx_Warning (CAN1)
41 INT_CAN1_Rx_Warning (CAN1)
42 INT_CAN1_Wake_Up (CAN1)
44 INT_UART0_LON (UART0)
45 INT_UART0_RX_TX (UART0)
46 INT_UART0_ERR (UART0)
47 INT_UART1_RX_TX (UART1)
48 INT_UART1_ERR (UART1)
49 INT_UART2_RX_TX (UART2)
50 INT_UART2_ERR (UART2)
51 INT_UART3_RX_TX (UART3)
52 INT_UART3_ERR (UART3)
53 INT_UART4_RX_TX (UART4)
54 INT_UART4_ERR (UART4)
55 INT_UART5_RX_TX (UART5)
56 INT_UART5_ERR (UART5)
57 INT_ADC0 (ADC0)
58 INT_ADC1 (ADC1)
59 INT_CMP0 (CMP0)
60 INT_CMP1 (CMP1)
61 INT_CMP2 (CMP2)
62 INT_FTM0 (FTM0)
63 INT_FTM1 (FTM1)
64 INT_FTM2 (FTM2)
65 INT_CMT (CMT)
66 INT_RTC (RTC)
67 INT_RTC_Seconds (RTC)
68 INT_PIT0 (PIT)
69 INT_PIT1 (PIT)
70 INT_PIT2 (PIT)
71 INT_PIT3 (PIT)
72 INT_PDB0 (PDB0)
73 INT_USB0 (USB0)
74 INT_USBDCD (USBDCD)
75 INT_ENET_1588_Timer (ENET)
76 INT_ENET_Transmit (ENET)
77 INT_ENET_Receive (ENET)
78 INT_ENET_Error (ENET)
80 INT_SDHC (SDHC)
81 INT_DAC0 (DAC0)
82 INT_DAC1 (DAC1)
83 INT_TSI0 (TSI0)
85 INT_LPTimer (LPTMR0)
87 INT_PORTA (PTA)
88 INT_PORTB (PTB)
89 INT_PORTC (PTC)
90 INT_PORTD (PTD)
91 INT_PORTE (PTE)
92 INT_PORTF (PTF)
93 INT_DDR (DDR)
95 INT_NFC (NFC)
96 INT_USBHS (USBHS)
97 INT_LCD (LCDC)
98 INT_CMP3 (CMP3)
99 INT_Tamper (DRY)
101 INT_FTM3 (FTM3)
102 INT_ADC2 (ADC2)
103 INT_ADC3 (ADC3)
104 INT_I2S1_Tx (I2S1)
105 INT_I2S1_Rx (I2S1)
