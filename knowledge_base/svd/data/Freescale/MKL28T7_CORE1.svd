# MKL28T7_CORE1 register map
Vendor: Freescale Semiconductor, Inc.; Series: Kinetis_L; File version: 1.6
MKL28T7_CORE1 Freescale Microcontroller
CPU: CM0PLUS r0p0, little endian, no MPU, no FPU, VTOR, 2 interrupt priority bits
Registers are 32-bit, read-write, reset 0x0 unless marked. A register's access mark holds for its fields unless they carry their own. Offsets are from the block's base; lines under a group give offsets from that group; [hi:lo] are bit positions; {n}, {i} and the like mark numbered series; 'fields as' and 'values as' point back to an identical list; <NAME> marks a mode.

## Memory map
0x00000400 FTFA_FlashConfig size 0xE — Flash configuration field
0x40001000 MSCM size 0x40C
0x40008000 DMA0 size 0x1100 — Enhanced direct memory access controller
0x4000F000 GPIOA size 0x18 — General Purpose Input/Output
0x4000F040 GPIOB size 0x18 — General Purpose Input/Output
0x4000F080 GPIOC size 0x18 — General Purpose Input/Output
0x4000F0C0 GPIOD size 0x18 — General Purpose Input/Output
0x4000F100 GPIOE size 0x18 — General Purpose Input/Output
0x40014000 XRDC size 0x2300
0x4001B000 SEMA420 size 0x44 — SEMA42
0x40020000 FTFA size 0x2C — Flash Memory Interface
0x40021000 DMAMUX0 size 0x8 — DMA channel multiplexor
0x40023000 MU0_A size 0x68 — MU
0x40027000 TRGMUX0 size 0x38
0x4002E000 TPM2 size 0x88 — Timer/PWM Module
0x40030000 LPIT0 size 0x5C — Low Power Periodic Interrupt Timer (LPIT)
0x40034000 LPTMR0 size 0x10 — Low Power Timer
0x40038000 RTC size 0x20 — Secure Real Time Clock
0x4003E000 LPSPI2 size 0x78 — The LPSPI Memory Map/Register Definition can be found here.
0x40042000 LPI2C2 size 0x174 — The LPI2C Memory Map/Register Definition can be found here.
0x40046000 LPUART2 size 0x30 — Universal Asynchronous Receiver/Transmitter
0x4004C000 I2S0 size 0xE4 — Inter-IC Sound / Synchronous Audio Interface
0x4004E000 EMVSIM0 size 0x4C — EMVSIM
0x40055000 USB0 size 0x15D — Universal Serial Bus, OTG Capable Controller
0x4005A000 PORTA size 0xCC — Pin Control and Interrupts
0x4005B000 PORTB size 0xCC — Pin Control and Interrupts
0x4005C000 PORTC size 0xCC — Pin Control and Interrupts
0x4005D000 PORTD size 0xCC — Pin Control and Interrupts
0x4005E000 PORTE size 0xCC — Pin Control and Interrupts
0x40061000 LLWU0 size 0x34 — Low leakage wakeup unit
0x40062000 TSI0 size 0xC — Touch sense input
0x40066000 ADC0 size 0x70 — Analog-to-Digital Converter
0x4006A000 DAC0 size 0x24 — 12-Bit Digital-to-Analog Converter
0x4006E000 CMP0 size 0x6 — High-Speed Comparator (CMP), Voltage Reference (VREF) Digital-to-Analog Converter (DAC), and Analog Mux (ANMUX)
0x40072000 VREF size 0x6 — Voltage Reference
0x40074000 SIM size 0x10F0 — System Integration Module
0x400750F0 TSTMR0 size 0x8 — Timestamp Timer
0x40076000 WDOG0 size 0x10 — Watchdog timer
0x40078000 CRC size 0xC — Cyclic Redundancy Check
0x4007A000 PCC0 blocks up to offset 0x1E4
0x4007B000 SCG size 0x60C — System Clock Generator
0x4007C000 RFSYS size 0x20 — System register file
0x4007D000 PMC size 0x38 — Power Management Controller
0x4007E000 SMC size 0x18 — System Mode Controller
0x4007F000 RCM size 0x20 — Reset Control Module
0x40088000 DMA1 size 0x1100 — Enhanced direct memory access controller
0x4008F000 GPIOM size 0x18 — General Purpose Input/Output
0x4009B000 SEMA421 size 0x44 — SEMA42
0x400A1000 DMAMUX1 size 0x8 — DMA channel multiplexor
0x400A3000 MU0_B size 0x68 — MU
0x400A4000 INTMUX1 size 0xE4 — Interrupt Multiplexer
0x400A5000 TRNG size 0xF8
0x400A7000 TRGMUX1 size 0x2C
0x400AC000 TPM0 size 0x88 — Timer/PWM Module
0x400AD000 TPM1 size 0x88 — Timer/PWM Module
0x400B1000 LPIT1 size 0x5C — Low Power Periodic Interrupt Timer (LPIT)
0x400B5000 LPTMR1 size 0x10 — Low Power Timer
0x400BC000 LPSPI0 size 0x78 — The LPSPI Memory Map/Register Definition can be found here.
0x400BD000 LPSPI1 size 0x78 — The LPSPI Memory Map/Register Definition can be found here.
0x400C0000 LPI2C0 size 0x174 — The LPI2C Memory Map/Register Definition can be found here.
0x400C1000 LPI2C1 size 0x174 — The LPI2C Memory Map/Register Definition can be found here.
0x400C4000 LPUART0 size 0x30 — Universal Asynchronous Receiver/Transmitter
0x400C5000 LPUART1 size 0x30 — Universal Asynchronous Receiver/Transmitter
0x400CA000 FLEXIO0 size 0x7A0
0x400E0000 PORTM size 0xCC — Pin Control and Interrupts
0x400E1000 LLWU1 size 0x34 — Low leakage wakeup unit
0x400EF000 CMP1 size 0x6 — High-Speed Comparator (CMP), Voltage Reference (VREF) Digital-to-Analog Converter (DAC), and Analog Mux (ANMUX)
0x400F5000 ASMC size 0x18 — ASMC (Auxiliary System Mode Control) Module
0x400F50F0 TSTMR1 size 0x8 — Timestamp Timer
0x400F6000 WDOG1 size 0x10 — Watchdog timer
0x400FA000 PCC1 blocks up to offset 0x1C0
0xF0000000 MTB0 size 0x1000 — Micro Trace Buffer
0xF0003000 MCM0 blocks up to offset 0x44 — Core Platform Miscellaneous Control Module
0xF0004000 MMDVSQ0 size 0x14 — Divide and Square Root
0xF0005000 CAU1 size 0xB6C — Memory Mapped Cryptographic Acceleration Unit (MMCAU)
0xF1000000 MTB1 size 0x1000 — Micro Trace Buffer
0xF1001000 MTB1_DWT size 0x1000 — MTB data watchpoint and trace
0xF1002000 MTB1_ROM size 0x1000 — System ROM
0xF1003000 MCM1 blocks up to offset 0x44 — Core Platform Miscellaneous Control Module
0xF1004000 MMDVSQ1 size 0x14 — Divide and Square Root
0xF8000000 FGPIOA size 0x18 — General Purpose Input/Output
0xF9000000 FGPIOM size 0x18 — General Purpose Input/Output

## Interrupts
0 DMA1_04 (DMA1)
1 DMA1_15 (DMA1)
2 DMA1_26 (DMA1)
3 DMA1_37 (DMA1)
4 CTI1_DMA1_Error (DMA1)
5 FLEXIO0
6 TPM0
7 TPM1
9 LPIT1
10 LPSPI0
11 LPSPI1
12 LPUART0
13 LPUART1
14 LPI2C0
15 LPI2C1
16 MU0_B
17 PORTM (GPIOM, PORTM)
18 TRNG
19 TSI0
20 DAC0
21 CMP1
22 LLWU1
23 I2S0
24 USB0
25 ADC0
26 LPTMR1
27 RTC_Seconds (RTC)
28 INTMUX1_0 (INTMUX1)
29 INTMUX1_1 (INTMUX1)
30 INTMUX1_2 (INTMUX1)
31 INTMUX1_3 (INTMUX1)
32 LPTMR0
33 LPIT0
34 TPM2
36 LPSPI2
37 LPUART2
38 EMVSIM0
39 LPI2C2
41 PMC
42 FTFA
43 SCG
44 XRDC
47 RCM
48 CMP0
50 RTC
51 PORTA (GPIOA, PORTA)
52 PORTB (GPIOB, PORTB)
53 PORTC (GPIOC, PORTC)
54 PORTD (GPIOD, PORTD)
55 PORTE (GPIOE, PORTE)
56 DMA0_04 (DMA0)
57 DMA0_15 (DMA0)
58 DMA0_26 (DMA0)
59 DMA0_37 (DMA0)
60 DMA0_Error (DMA0)

## Licence text in the file
Redistribution and use in source and binary forms, with or without modification, are permitted provided that the following conditions are met: o Redistributions of source code must retain the above copyright notice, this list of conditions and the following disclaimer. o Redistributions in binary form must reproduce the above copyright notice, this list of conditions and the following disclaimer in the documentation and/or other materials provided with the distribution. o Neither the name of Freescale Semiconductor, Inc. nor the names of its contributors may be used to endorse or promote products derived from this software without specific prior written permission. THIS SOFTWARE IS PROVIDED BY THE COPYRIGHT HOLDERS AND CONTRIBUTORS "AS IS" AND. ANY EXPRESS OR IMPLIED WARRANTIES, INCLUDING, BUT NOT LIMITED TO, THE IMPLIED. WARRANTIES OF MERCHANTABILITY AND FITNESS FOR A PARTICULAR PURPOSE ARE. DISCLAIMED. IN NO EVENT SHALL THE COPYRIGHT HOLDER OR CONTRIBUTORS BE LIABLE FOR. ANY DIRECT, INDIRECT, INCIDENTAL, SPECIAL, EXEMPLARY, OR CONSEQUENTIAL DAMAGES (INCLUDING, BUT NOT LIMITED TO, PROCUREMENT OF SUBSTITUTE GOODS OR SERVICES; LOSS OF USE, DATA, OR PROFITS; OR BUSINESS INTERRUPTION) HOWEVER CAUSED AND ON. ANY THEORY OF LIABILITY, WHETHER IN CONTRACT, STRICT LIABILITY, OR TORT (INCLUDING NEGLIGENCE OR OTHERWISE) ARISING IN ANY WAY OUT OF THE USE OF THIS. SOFTWARE, EVEN IF ADVISED OF THE POSSIBILITY OF SUCH DAMAGE.
