# STM32H7x7_CM7 register map
File version: 1.0
CPU: CM7 r0p1, little endian, MPU, FPU, 4 interrupt priority bits
Registers are 32-bit, read-write, reset 0x0 unless marked. A register's access mark holds for its fields unless they carry their own. Offsets are from the block's base; lines under a group give offsets from that group; [hi:lo] are bit positions; {n}, {i} and the like mark numbered series; 'fields as' and 'values as' point back to an identical list; <NAME> marks a mode.

## Memory map
0x40000000 TIM2 size 0x400 — General purpose timers
0x40000400 TIM3 size 0x400
0x40000800 TIM4 size 0x400
0x40000C00 TIM5 size 0x400
0x40001000 TIM6 size 0x400 — Basic timers
0x40001400 TIM7 size 0x400
0x40001800 TIM12 size 0x400 — General purpose timers
0x40001C00 TIM13 size 0x400 — General purpose timers
0x40002000 TIM14 size 0x400 — General purpose timers
0x40002400 LPTIM1 size 0x400 — Low power timer
0x40002C00 WWDG1 size 0x400 — WWDG
0x40003800 SPI2 size 0x400
0x40003C00 SPI3 size 0x400
0x40004000 SPDIFRX size 0x400 — Receiver Interface
0x40004400 USART2 size 0x400
0x40004800 USART3 size 0x400
0x40004C00 UART4 size 0x400 — Universal synchronous asynchronous receiver transmitter
0x40005000 UART5 size 0x400
0x40005400 I2C1 size 0x400 — I2C
0x40005800 I2C2 size 0x400
0x40005C00 I2C3 size 0x400
0x40006C00 CEC size 0x400
0x40007400 DAC size 0x400
0x40007800 UART7 size 0x400
0x40007C00 UART8 size 0x400
0x40008400 CRS size 0x400
0x40008800 SWPMI size 0x400 — Single Wire Protocol Master Interface
0x40009000 OPAMP size 0x400 — Operational amplifiers
0x40009400 MDIOS size 0x400 — Management data input/output slave
0x4000A000 FDCAN1 size 0x400 — FDCAN
0x4000A400 FDCAN2 size 0x400
0x4000A800 CAN_CCU size 0x400 — CCU registers
0x40010000 TIM1 size 0x400 — Advanced-timers
0x40010400 TIM8 size 0x400
0x40011000 USART1 size 0x400 — Universal synchronous asynchronous receiver transmitter
0x40011400 USART6 size 0x400
0x40013000 SPI1 size 0x400 — Serial peripheral interface
0x40013400 SPI4 size 0x400
0x40014000 TIM15 size 0x400 — General purpose timers
0x40014400 TIM16 size 0x400 — General-purpose-timers
0x40014800 TIM17 size 0x400 — General-purpose-timers
0x40015000 SPI5 size 0x400
0x40015800 SAI1 size 0x400
0x40015C00 SAI2 size 0x400
0x40016000 SAI3 size 0x400
0x40017000 DFSDM size 0x400 — Digital filter for sigma delta modulators
0x40017400 HRTIM_Master size 0x80 — High Resolution Timer: Master Timers
0x40017480 HRTIM_TIMA size 0x80 — High Resolution Timer: TIMA
0x40017500 HRTIM_TIMB size 0x80 — High Resolution Timer: TIMB
0x40017580 HRTIM_TIMC size 0x80 — High Resolution Timer: TIMC
0x40017600 HRTIM_TIMD size 0x80 — High Resolution Timer: TIMD
0x40017680 HRTIM_TIME size 0x80 — High Resolution Timer: TIME
0x40017780 HRTIM_Common size 0x80 — High Resolution Timer: Common functions
0x40020000 DMA1 size 0x400 — DMA controller
0x40020400 DMA2 size 0x400
0x40020800 DMAMUX1 size 0x400 — DMAMUX
0x40022000 ADC1_2 size 0x400 — Analog to Digital Converter
0x40024400 ART size 0x400 — accelerator - control register (ART_CTR)
0x40028000 Ethernet_MAC size 0x1400 — Ethernet: media access control (MAC)
0x40040000 OTG_HS_GLOBAL size 0x400 — USB on the go high speed
0x40040400 OTG_HS_HOST size 0x400 — USB on the go high speed
0x40040800 OTG_HS_DEVICE size 0x500 — USB on the go high speed
0x40040E00 OTG_HS_PWRCLK size 0x3F200 — USB on the go high speed
0x40080000 OTG_FS_GLOBAL size 0x400
0x40080400 OTG_FS_HOST size 0x400
0x40080800 OTG_FS_DEVICE size 0x500
0x40080E00 OTG_FS_PWRCLK size 0x3F200
0x48020000 DCMI size 0x400 — Digital camera interface
0x48021000 CRYP size 0x400 — Cryptographic processor
0x48021400 HASH size 0x400 — Hash processor
0x48021800 RNG size 0x400
0x48022400 SDMMC2 size 0x400
0x48023000 RAMECC2 size 0x400 — ECC controller is associated to each RAM area
0x50001000 LTDC size 0x1000 — LCD-TFT Controller
0x50003000 WWDG2 size 0x400
0x52000000 MDMA size 0x1000
0x52001000 DMA2D size 0x400
0x52003000 JPEG size 0x1000
0x52004000 FMC size 0x1000
0x52005000 QUADSPI size 0x1000
0x52007000 SDMMC1 size 0x1000
0x52009000 RAMECC1 size 0x400 — ECC controller is associated to each RAM area
0x58000000 EXTI size 0x400 — External interrupt/event controller
0x58000400 SYSCFG size 0x400 — System configuration controller
0x58000C00 LPUART1 size 0x400
0x58001400 SPI6 size 0x400
0x58001C00 I2C4 size 0x400
0x58002400 LPTIM2 size 0x400
0x58002800 LPTIM3 size 0x400 — Low power timer
0x58002C00 LPTIM4 size 0x400
0x58003000 LPTIM5 size 0x400
0x58003800 COMP1 size 0x400
0x58003C00 VREFBUF size 0x400
0x58004000 RTC size 0x400
0x58004800 IWDG1 size 0x400 — IWDG
0x58004C00 IWDG2 size 0x400
0x58005400 SAI4 size 0x400 — SAI
0x58020000 GPIOA size 0x400 — GPIO
0x58020400 GPIOB size 0x400 — GPIO
0x58020800 GPIOC size 0x400 — GPIO
0x58020C00 GPIOD size 0x400
0x58021000 GPIOE size 0x400
0x58021400 GPIOF size 0x400
0x58021800 GPIOG size 0x400
0x58021C00 GPIOH size 0x400
0x58022000 GPIOI size 0x400
0x58022400 GPIOJ size 0x400
0x58022800 GPIOK size 0x400
0x58024400 RCC size 0x400 — Reset and clock control
0x58024800 PWR size 0x400
0x58024C00 CRC size 0x400 — Cryptographic processor
0x58025400 BDMA size 0x400
0x58025800 DMAMUX2 size 0x400 — DMAMUX
0x58026000 ADC3 size 0x400 — Analog to Digital Converter
0x58026400 HSEM size 0x400
0x58027000 RAMECC3 size 0x400 — ECC controller is associated to each RAM area
0xE000E008 SCB_ACTRL size 0x5 — System control block ACTLR
0xE000E010 STK size 0x11 — SysTick timer
0xE000E100 NVIC size 0x351 — Nested Vectored Interrupt Controller
0xE000ED00 SCB size 0x41 — System control block
0xE000ED88 FPU_CPACR size 0x5 — Floating point unit CPACR
0xE000ED90 MPU size 0x15 — Memory protection unit
0xE000EF00 NVIC_STIR size 0x5 — Nested vectored interrupt controller

## Interrupts
0 WWDG1 — Window Watchdog interrupt
1 PVD_PVM (DFSDM) — PVD through EXTI line
2 RTC_TAMP_STAMP_CSS_LSE (RTC) — RTC tamper, timestamp
3 RTC_WKUP (RTC) — RTC Wakeup interrupt
5 RCC (LPTIM1) — RCC global interrupt
6 EXTI0 (DFSDM) — EXTI Line 0 interrupt
7 EXTI1 (DFSDM) — EXTI Line 1 interrupt
8 EXTI2 (DFSDM) — EXTI Line 2 interrupt
9 EXTI3 (DFSDM) — EXTI Line 3interrupt
10 EXTI4 (DFSDM) — EXTI Line 4interrupt
11 DMA_STR0 (DMA2) — DMA1 Stream0
12 DMA_STR1 (DMA2) — DMA1 Stream1
13 DMA_STR2 (DMA2) — DMA1 Stream2
14 DMA_STR3 (DMA2) — DMA1 Stream3
15 DMA_STR4 (DMA2) — DMA1 Stream4
16 DMA_STR5 (DMA2) — DMA1 Stream5
17 DMA_STR6 (DMA2) — DMA1 Stream6
18 ADC1_2 (DMAMUX1) — ADC1 and ADC2
19 CAN1_TX (TIM16) — CAN1 TX interrupts
20 CAN1_RX0 (TIM16) — CAN1 RX0 interrupts
21 CAN1_RX1 (TIM16) — CAN1 RX1 interrupts
22 CAN1_SCE (TIM16) — CAN1 SCE interrupt
23 EXTI9_5 (DFSDM) — EXTI Line[9:5] interrupts
24 TIM1_BRK (TIM8) — TIM1 break interrupt
25 TIM1_UP (TIM8) — TIM1 update interrupt
26 TIM1_TRG_COM (TIM8) — TIM1 trigger and commutation
27 TIM_CC (TIM8) — TIM1 capture / compare
28 TIM2 (TIM3) — TIM2 global interrupt
29 TIM3 (TIM4) — TIM3 global interrupt
30 TIM4 (TIM5) — TIM4 global interrupt
31 I2C1_EV (I2C1) — I2C1 event interrupt
32 I2C1_ER (I2C1) — I2C1 error interrupt
33 I2C2_EV (I2C2) — I2C2 event interrupt
34 I2C2_ER (I2C2) — I2C2 error interrupt
37 USART1 (USART2) — USART1 global interrupt
38 USART2 (UART5) — USART2 global interrupt
39 USART3 (UART4) — USART3 global interrupt
40 EXTI15_10 (DFSDM) — EXTI Line[15:10] interrupts
41 RTC_ALARM (RTC) — RTC alarms (A and B)
42 OTG_FS_WKUP (OTG_FS_GLOBAL, OTG_HS_PWRCLK) — USB On-The-Go FS Wakeup through EXTI line interrupt
43 TIM8_BRK_TIM12 (HRTIM_Master) — TIM8 and 12 break global
44 TIM8_UP_TIM13 (HRTIM_Master) — TIM8 and 13 update global
45 TIM8_TRG_COM_TIM14 (HRTIM_Master) — TIM8 and 14 trigger /commutation and global
46 TIM8_CC (HRTIM_Master) — TIM8 capture / compare
47 DMA1_STR7 (DMA2) — DMA1 Stream7
48 FMC — FMC global interrupt
49 SDMMC1 — SDMMC global interrupt
50 TIM5 (TIM12) — TIM5 global interrupt
51 SPI3 (SPI4) — SPI3 global interrupt
52 UART4 (OPAMP) — UART4 global interrupt
53 UART5 (USART6) — UART5 global interrupt
54 TIM6_DAC (TIM7) — TIM6 global interrupt
55 TIM7 (TIM1) — TIM7 global interrupt
56 DMA2_STR0 (USART1) — DMA2 Stream0 interrupt
57 DMA2_STR1 (USART1) — DMA2 Stream1 interrupt
58 DMA2_STR2 (USART1) — DMA2 Stream2 interrupt
59 DMA2_STR3 (USART1) — DMA2 Stream3 interrupt
60 DMA2_STR4 (USART1) — DMA2 Stream4 interrupt
61 ETH (OTG_HS_HOST) — Ethernet global interrupt
62 ETH_WKUP (OTG_HS_HOST) — Ethernet wakeup through EXTI
63 FDCAN_CAL (FDCAN2) — FDCAN calibration interrupts
68 DMA2_STR5 (USART1) — DMA2 Stream5 interrupt
69 DMA2_STR6 (USART1) — DMA2 Stream6 interrupt
70 DMA2_STR7 (USART1) — DMA2 Stream7 interrupt
71 USART6 (UART7) — USART6 global interrupt
72 I2C3_EV (I2C3) — I2C3 event interrupt
73 I2C3_ER (I2C3) — I2C3 error interrupt
74 OTG_HS_EP1_OUT (OTG_FS_GLOBAL) — OTG_HS out global interrupt
75 OTG_HS_EP1_IN (OTG_FS_GLOBAL) — OTG_HS in global interrupt
76 OTG_HS_WKUP (OTG_FS_DEVICE) — OTG_HS wakeup interrupt
77 OTG_HS (OTG_FS_GLOBAL) — OTG_HS global interrupt
78 DCMI (MDIOS) — DCMI global interrupt
79 CRYP (DMA1) — CRYP global interrupt
80 HASH_RNG (CRYP) — HASH and RNG
81 FPU (FPU_CPACR) — CPU1 FPU
82 UART7 (UART8) — UART7 global interrupt
83 UART8 (USART3) — UART8 global interrupt
84 SPI4 (SPI5) — SPI4 global interrupt
85 SPI5 (SPI6) — SPI5 global interrupt
86 SPI6 (LTDC) — SPI6 global interrupt
87 SAI1 — SAI1 global interrupt
88 LTDC (SPDIFRX) — LCD-TFT global interrupt
89 LTDC_ER (SPDIFRX) — LCD-TFT error interrupt
90 DMA2D — DMA2D global interrupt
91 SAI2 — SAI2 global interrupt
92 QUADSPI — QuadSPI global interrupt
93 LPTIM1 (LPTIM2) — LPTIM1 global interrupt
94 CEC — HDMI-CEC global interrupt
95 I2C4_EV (I2C4) — I2C4 event interrupt
96 I2C4_ER (I2C4) — I2C4 error interrupt
97 SPDIF (ADC3) — SPDIFRX global interrupt
98 OTG_FS_EP1_OUT (OTG_HS_PWRCLK) — OTG_FS out global interrupt
99 OTG_FS_EP1_IN (OTG_HS_PWRCLK) — OTG_FS in global interrupt
100 OTG_FS_WKUP (RAMECC2) — OTG_FS wakeup
101 OTG_FS (OTG_HS_PWRCLK) — OTG_FS global interrupt
102 DMAMUX1_OV (CRC) — DMAMUX1 overrun interrupt
103 HRTIM1_MST (HRTIM_TIMA) — HRTIM1 master timer interrupt
104 HRTIM1_TIMA (HRTIM_TIMB) — HRTIM1 timer A interrupt
105 HRTIM_TIMB (HRTIM_TIMC) — HRTIM1 timer B interrupt
106 HRTIM1_TIMC (HRTIM_TIMD) — HRTIM1 timer C interrupt
107 HRTIM1_TIMD (HRTIM_TIME) — HRTIM1 timer D interrupt
108 HRTIM_TIME (HASH) — HRTIM1 timer E interrupt
109 HRTIM1_FLT (Ethernet_MAC) — HRTIM1 fault interrupt
110 DFSDM1_FLT0 (ART) — DFSDM1_FLT0 global interrupt
111 DFSDM1_FLT1 (ART) — DFSDM1_FLT1 global interrupt
112 DFSDM1_FLT2 (ART) — DFSDM1_FLT2 global interrupt
113 DFSDM1_FLT3 (ART) — DFSDM1_FLT3 global interrupt
114 SAI3 — SAI3 global interrupt
116 TIM15 (TIM2) — TIM15 global interrupt
117 TIM16 (TIM17) — TIM16 global interrupt
118 TIM17 (TIM15) — TIM17 global interrupt
119 MDIOS_WKUP (SWPMI) — MDIOS wakeup
120 MDIOS (SWPMI) — MDIOS global interrupt
121 JPEG — JPEG global interrupt
122 MDMA
123 DSI (CRC) — DSI Host global interrupt
124 SDMMC (SDMMC1, SDMMC2) — SDMMC global interrupt
125 HSEM0 (HSEM) — HSEM global interrupt 1
126 HSEM1 (HSEM) — HSEM global interrupt 2
127 ADC3 (ADC1_2) — ADC3 global interrupt
128 DMAMUX2_OVR (DMAMUX2) — DMAMUX2 overrun interrupt
{n+128} BDMA_CH{n} (BDMA) (n=1..8) — BDMA channel {n} interrupt
137 COMP (COMP1) — COMP1 and COMP2
138 LPTIM2 (LPTIM3) — LPTIM2 timer interrupt
139 LPTIM3 (LPTIM4) — LPTIM2 timer interrupt
140 LPTIM4 (LPTIM5) — LPTIM2 timer interrupt
141 LPTIM5 (LPUART1) — LPTIM2 timer interrupt
142 LPUART (SYSCFG) — LPUART global interrupt
143 WWDG2_RST (WWDG2) — Window Watchdog interrupt
144 CRS — Clock Recovery System globa
146 SAI4 — SAI4 global interrupt
148 HOLD_CORE (FPU_CPACR) — HOLD_CORE_CPU1
149 WKUP (DFSDM) — WKUP1 to WKUP6 pins
